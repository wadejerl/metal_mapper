/*
 * metal_detector.c - PI metal detector sequencer (stm_detector3, STM32G474)
 *
 * HARDWARE-TIMELINE ARCHITECTURE (rev 2)
 *
 * All four timers run one shared absolute timeline in one-pulse mode,
 * started by a single hardware trigger. No ISR sits between any two
 * critical edges, so Set A and Set B align to one timer clock (~6 ns)
 * and blanking is exact and identical every cycle.
 *
 *   TIM2  master: TRGO = counter-enable (MMS=Enable). Set A TX on CH1.
 *   TIM3  slave (trigger mode, ITR1 = TIM2_TRGO): Set B TX on CH1.
 *   TIM1  slave (ITR1): Set A aux (CH2 gain / CH3 integ / CH4 RX).
 *   TIM8  slave (ITR1): Set B aux (CH1 gain / CH3 integ / CH4N RX).
 *
 * All PSC=0 → 170 MHz ticks. Timeline (md_start_cycle sets TIM2 CEN;
 * every armed slave starts in the same kernel clock):
 *
 *   t = 1 tick            TX pins HIGH   (PWM2 compare, CCR=1)
 *   t = tx                TX pins LOW    (TX timers' OPM update; they stop)
 *                         (tx = coil charge time, f/v keys 10-120 µs, dfl 120)
 *   t = tx + bl           gain HIGH, integ HIGH, RX pins connect
 *                         (aux compares, one CCR value — same clock, both sets)
 *   t = tx + bl + rx      RX pins disconnect (aux OPM update clears the PWM2
 *                         ref in hardware); TIM1's UIE starts the ADC reads.
 *   + ~45 µs              all four ADCs finish their 2-channel injected
 *                         sequences (16x oversampled — all 8 inputs, every
 *                         cycle); the last JEOS releases gain + integ —
 *                         deliberately non-critical (integrators hold until
 *                         they have been sampled).
 *
 * ADC plan: each ADC converts its own pin pair as a software-started
 * injected sequence (results in JDR1/JDR2 — no DMA). TIM1 runs the
 * timeline; its UIE kicks all four ADCs every cycle and adjacent-coil
 * cross-reads come for free.
 *   ADC1: PA0/PA1 (IN1/IN2)    ADC2: PA6/PA7  (IN3/IN4)
 *   ADC3: PB1/PB13 (IN1/IN5)   ADC4: PB12/PB14 (IN3/IN4)
 *
 * RASTER MODE ('r' key): instead of one simultaneous cycle per sample
 * tick, the pacer runs 8 slots at a fixed slot period (md_slot_ticks x
 * 100 µs, min 200 µs). Slot k fires ONLY channel k's bus with channel k's
 * own {tx, blanking, rx} from the per-channel table, and converts only
 * channel k (single-conversion JSQR, ~23 µs). The idle set's TX and aux
 * outputs are parked Force-Inactive — its coils don't fire and its
 * integrators stay reset. One md_frame_t publishes per completed sweep,
 * so the wire format is unchanged: value k was measured at
 * sweep_start + k*slot_period (the host learns slot_us from the info
 * line). This is the only route to per-channel timing — the gain/integ/RX
 * gates are bussed per set with a single compare value each.
 *
 * TX channels use PWM mode 2 (ref = CNT >= CCR) with CCR = 1 tick: while a
 * timer sits stopped at CNT=0 the ref is LOW, so idle pins are safe — the
 * reason detector2 used force modes instead of plain PWM1. The RX-connect
 * channels use the same trick for a fully hardware 3 µs window: ref rises
 * at the aux compare and falls when the OPM update reloads CNT to 0.
 *
 * Gain/integ channels use Active-on-compare, which latches the ref HIGH
 * through the OPM stop — exactly what the integrator-hold requires.
 *
 * Both coil sets fire every cycle. (Single-set firing — the old 1/2/3
 * "fire mode" keys — was a bring-up diagnostic, removed once all 8
 * coils were validated.)
 *
 * Set A: TX=TIM2 CH1 (PA5), TIM1: CH2=PA9 gain, CH3=PA10 integ,
 *        CH4=PA11 RX connect (CC4P=1 inverts).
 * Set B: TX=TIM3 CH1 (PB4), TIM8: CH1=PA15 gain, CH3=PB9 integ,
 *        CH4N=PC13 RX connect (CC4NP=1 inverts; CC4NE/OIS4N bits).
 *
 * CubeMX still generates a baseline init (PSC=169, TIMING modes); this
 * module owns the final register state, as detector2's MD init did.
 */

#include "metal_detector.h"
#include "main.h"
#include "gps.h"      /* gps_passthrough_enabled ('G' key), module identity */
#include <stdio.h>
#include <string.h>

/* Generated by gen_version.sh (gitignored); builds without it still work
 * so a fresh clone compiles in the IDE before the pre-build step is set. */
#if __has_include("fw_version.h")
#include "fw_version.h"
#else
#define FW_GIT_HASH "unknown"
#endif

extern TIM_HandleTypeDef htim1;
extern TIM_HandleTypeDef htim2;
extern TIM_HandleTypeDef htim3;
extern TIM_HandleTypeDef htim8;
extern ADC_HandleTypeDef hadc1;
extern ADC_HandleTypeDef hadc2;
extern ADC_HandleTypeDef hadc3;
extern ADC_HandleTypeDef hadc4;
extern ADC_HandleTypeDef hadc5;

volatile uint32_t md_tx_pulse_us  = MD_TX_PULSE_US;   /* coil charge time */
volatile uint32_t md_blanking_us  = MD_BLANKING_US;
volatile uint32_t md_rx_window_us = MD_RX_WINDOW_US;
volatile uint32_t md_cycle_count  = 0;

/* Coil-array geometry — set at provisioning time (d/c keys + SAVE),
 * reported by the 'I' info line so studies get tagged with the producing
 * unit's physical layout. The web visualizer combines these with the GPS
 * heading to place each coil's samples. */
volatile uint32_t md_coil_spacing_mm      = MD_COIL_SPACING_MM_DEFAULT;
volatile int32_t  md_coil_offset_fore_mm  = 0;   /* array center vs antenna */
volatile int32_t  md_coil_offset_right_mm = MD_COIL_OFFSET_RIGHT_MM_DEFAULT;

/* DWT cycle timestamps (debug aid) */
volatile uint32_t md_ts_cen;
volatile uint32_t md_ts_opm;

#define MD_TICKS_PER_US  170U     /* PSC=0 at 170 MHz timer clock */

/* Tuning limits: the aux timers are 16-bit at 170 MHz ticks, so
 * (tx + blanking + rx) must stay <= 385 us or ARR overflows — holds at
 * every limit (120 + 200 + 50 = 370). TX pulse capped at the old fixed
 * 120 us: longer charges overheat the TX FETs (f/v keys, bench tunable). */
#define MD_TX_PULSE_MIN_US   10U
#define MD_TX_PULSE_MAX_US   120U
#define MD_BLANKING_MAX_US   200U
#define MD_RX_WINDOW_MAX_US  50U

/* Coil geometry limits (sanity only — no hardware constraint) */
#define MD_COIL_SPACING_MM_MIN    50U
#define MD_COIL_SPACING_MM_MAX    5000U
#define MD_COIL_OFFSET_MM_LIMIT   5000

/* ---------------------------------------------------------------------------
 * Raster mode: per-channel slot timing (see the header comment above).
 *
 * Channel -> bus map: even channels ride Set/Bus A (TX PA5/TIM2), odd
 * channels Set/Bus B (TX PB4/TIM3). INFERRED from the ADC pair structure
 * (each ADC's injected pair is one even + one odd channel, i.e. one Set A
 * + one Set B front end); the pre-raster firmware never needed this map
 * because both sets always fired with identical timing. VALIDATE ON THE
 * ANALYZER before trusting raster data — if it is backwards, flip this
 * macro and nothing else.
 * ------------------------------------------------------------------------- */
#define MD_CH_SET_B(k)    ((k) & 1U)  /* 1 = Set B fires channel k's slot   */

#define MD_SEL_ALL        8U    /* md_sel_ch value: edit all 8 in lockstep  */
#define MD_SLOT_TICKS_MIN 2U    /* 200 µs floor: eddy settle between slots  */
#define MD_SLOT_ADC_US    25U   /* one 16x-oversampled conversion is ~23 µs */
#define MD_SLOT_MARGIN_US 5U    /* UIE-to-JADSTART latency + slack          */
#define MD_PACE_TICKS_PER_MS 10U   /* TIM7 timebase: 0.1 ms ticks (10 kHz)  */

static volatile uint8_t md_raster = 0U;         /* 0 = all-at-once, 1 = raster */
static volatile uint8_t md_sel_ch = MD_SEL_ALL; /* console edit target         */
static volatile uint8_t md_ch_tx_us[8];         /* per-channel table — raster  */
static volatile uint8_t md_ch_bl_us[8];         /*   mode only; seeded by      */
static volatile uint8_t md_ch_rx_us[8];         /*   MD_Load_Settings          */
static volatile uint8_t md_slot_ticks = MD_SLOT_TICKS_MIN;   /* slot period   */

/* Requested pulse spacing (raster slot-period floor), 0.1 ms ticks. The
 * effective slot period is max(this, the worst channel's timeline) — the
 * h/n console keys step it through the list below. MIN (200 µs) means "as
 * fast as the timings allow", the original raster behavior. Slower spacing
 * exists because sensitivity drops when the channels are scanned too fast
 * (the previous slot's eddy tail bleeds into the next read); the field
 * wants ~160/240 Hz spacing, so the list carries the closest periods the
 * 0.1 ms pacer tick can express (6.2 ms = 161 Hz, 4.2 ms = 238 Hz). */
static volatile uint8_t md_pulse_ticks = MD_SLOT_TICKS_MIN;
static uint8_t md_slot_want = MD_SLOT_TICKS_MIN;  /* last slot-period candidate
    computed by md_raster_apply — kept on refusal too, so the raster-limit
    warn can print the number that actually failed the fit (task ctx only) */
static const uint8_t md_pulse_steps[] = {   /* ticks (rate): */
    2U,     /* 200 µs  5000 Hz — as fast as the timings allow (default) */
    5U,     /* 500 µs  2000 Hz */
    10U,    /*   1 ms  1000 Hz */
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    250U,   /*  25 ms    40 Hz — uint8 tick ceiling                    */
};
#define MD_PULSE_STEPS (sizeof(md_pulse_steps) / sizeof(md_pulse_steps[0]))

#define MD_CYC_PER_US 170U   /* DWT CYCCNT runs at HCLK = 170 MHz */

static inline uint32_t dwt_cyccnt(void)
{
    if (!(CoreDebug->DEMCR & CoreDebug_DEMCR_TRCENA_Msk))
        CoreDebug->DEMCR |= CoreDebug_DEMCR_TRCENA_Msk;
    if (!(DWT->CTRL & DWT_CTRL_CYCCNTENA_Msk))
        DWT->CTRL |= DWT_CTRL_CYCCNTENA_Msk;
    return DWT->CYCCNT;
}

/* Cycles -> whole microseconds, rounded (spans well under the 25 s DWT wrap) */
static inline uint32_t md_cyc_to_us(uint32_t cyc)
{
    return (cyc + MD_CYC_PER_US / 2U) / MD_CYC_PER_US;
}

/* ---------------------------------------------------------------------------
 * Per-set descriptor. Set B's gain-protect lives on CH1 (A: CH2), so CCMR
 * access is channel-indexed. Bit positions are identical H7 ↔ G4.
 * ------------------------------------------------------------------------- */
typedef struct {
    TIM_TypeDef *tx;        /* TX pulse timer; coil on CH1                  */
    TIM_TypeDef *opm;       /* aux one-pulse timer                          */
    uint8_t      gain_ch;   /* gain-protect release channel (A:2, B:1)     */
    uint8_t      integ_ch;  /* integrator enable channel (3 on both)        */
    uint8_t      rx_ch;     /* RX connect channel, inverted pol (4 on both) */
} md_set_t;

static md_set_t md_set_a = { TIM2, TIM1, 2, 3, 4 };
static md_set_t md_set_b = { TIM3, TIM8, 1, 3, 4 };

/* OCxM 3-bit mode values (extended 4th bit always 0 for these modes) */
#define MD_OCM_ACT_ON_CMP    1U   /* OCxREF→1 when CNT=CCRx, latches        */
#define MD_OCM_FORCE_INACT   4U   /* OCxREF=0 immediately                   */
#define MD_OCM_PWM2          7U   /* OCxREF=1 while CNT>=CCRx (self-clears
                                     at OPM update when CNT reloads to 0)   */

/* Write OCxM for channel ch (1..4): CH1/CH3 sit at bits [6:4]+[16] of
 * CCMR1/CCMR2, CH2/CH4 at bits [14:12]+[24]. */
static inline void md_oc_mode(TIM_TypeDef *tim, uint8_t ch, uint32_t mode)
{
    volatile uint32_t *ccmr = (ch <= 2) ? &tim->CCMR1 : &tim->CCMR2;
    uint32_t lo   = (ch & 1U) ? 4U : 12U;
    uint32_t ext  = (ch & 1U) ? 16U : 24U;
    uint32_t mask = (7U << lo) | (1U << ext);
    *ccmr = (*ccmr & ~mask) | (mode << lo);
}

/* CCRx for channel ch (1..4) — consecutive registers */
static inline void md_set_ccr(TIM_TypeDef *tim, uint8_t ch, uint32_t val)
{
    (&tim->CCR1)[ch - 1U] = val;
}

/* Slave a timer to TIM2_TRGO in trigger mode: counter starts in hardware
 * on the master's CEN rising edge. ITR1 = tim2_trgo for TIM1/TIM8
 * (RM0440 Table 267) and TIM3 (Table 291). */
static inline void md_slave_to_tim2(TIM_TypeDef *tim)
{
    tim->SMCR = (tim->SMCR & ~(TIM_SMCR_TS | TIM_SMCR_SMS))
                | TIM_TS_ITR1 | TIM_SLAVEMODE_TRIGGER;
}

/* ---------------------------------------------------------------------------
 * ADC: one injected pair per ADC, all four kicked together from TIM1's UIE.
 * md_adc[] order is the CSV order.
 * ------------------------------------------------------------------------- */
volatile uint16_t md_adc[MD_ADC_COUNT];

/* Sample ticks (see metal_detector.h): md_sample_tick numbers every pacer
 * fire; md_tick_inflight is the started cycle's number (exactly one cycle
 * runs at a time — md_start_cycle refuses overlap); md_tick_completed is
 * published for the GGA anchor stamp when the frame lands. */
static volatile uint32_t md_sample_tick   = 0U;
static volatile uint32_t md_tick_inflight = 0U;
volatile uint32_t md_tick_completed       = 0U;

/* Raster sweep state — written by the TIM7 pacer ISR (priority 4), read
 * by the aux-UIE (2) and JEOS (3) ISRs. Every field settles microseconds
 * before the hardware event that reads it (a slot's UIE can't fire until
 * tx+bl+rx after the pacer armed it), so no locking is needed — the same
 * timing argument md_start_cycle already relies on. */
static volatile uint8_t md_slot        = 0U;  /* next slot to fire (0..7)   */
static volatile uint8_t md_sweep_ok    = 0U;  /* all slots so far started   */
static volatile uint8_t md_slot_ch     = 0U;  /* channel converting now     */
/* Mode latches: md_raster is read ONLY at cycle/slot start (pacer) — the
 * in-flight cycle's UIE routing reads md_cycle_raster and the JEOS collect
 * reads md_kick_raster, both latched when their phase began, so a console
 * toggle mid-cycle can't misroute a cycle already in the hardware. */
static volatile uint8_t md_cycle_raster = 0U; /* latched at CEN write       */
static volatile uint8_t md_kick_raster  = 0U; /* latched at JADSTART        */
/* Pacer diagnostics — the 'P' console key prints them as one '# pace'
 * line and resets the window. The pacer ISR (priority 4) writes the fire
 * side; the GPS fix path (USART2 ISR, priority 6) writes the fix side
 * and only READS the fire stamp. A fire that preempts a fix read tears
 * one diagnostic sample, never the cadence — these numbers steer nothing.
 * DWT cycle counts (MD_CYC_PER_US per µs); 0 = "no stamp yet". */
static volatile uint32_t md_pd_fire_cyc  = 0U;  /* last cycle/sweep CEN stamp */
static volatile uint32_t md_pd_prev_ivl  = 0U;  /* previous fire-to-fire, µs  */
static volatile uint32_t md_pd_fires     = 0U;  /* cycles/sweeps started      */
static volatile uint32_t md_pd_skips     = 0U;  /* starts refused (overlap)   */
static volatile uint32_t md_pd_dev_max   = 0U;  /* max |interval - nominal| µs*/
static volatile uint32_t md_pd_jit_max   = 0U;  /* max |interval - previous|  */
static volatile uint32_t md_pd_fix_cyc   = 0U;  /* last valid GGA parse stamp */
static volatile uint32_t md_pd_fix_ms    = 0U;  /* ...and its HAL ms tick: the
                                                   dropout guard (>1 s) runs on
                                                   this so the 25 s DWT wrap
                                                   can't fake a short span  */
static volatile uint32_t md_pd_fix_n     = 0U;  /* valid GGAs seen            */
static volatile uint32_t md_pd_fix_span_min = 0xFFFFFFFFU; /* GGA-to-GGA µs */
static volatile uint32_t md_pd_fix_span_max = 0U;
static volatile uint32_t md_pd_fix_ph    = 0U;  /* last GGA: µs after a fire  */
static volatile uint32_t md_pd_gps_isr_max = 0U; /* longest NMEA parse, µs   */

/* Task context (console, save, the raster brackets, boot). A fire landing
 * mid-reset loses one interval of statistics — nothing else. */
static void md_pace_diag_reset(void)
{
    md_pd_fire_cyc = 0U;   md_pd_prev_ivl = 0U;
    md_pd_fires    = 0U;   md_pd_skips    = 0U;
    md_pd_dev_max  = 0U;   md_pd_jit_max  = 0U;
    md_pd_fix_cyc  = 0U;   md_pd_fix_ms   = 0U;   md_pd_fix_n = 0U;
    md_pd_fix_span_min = 0xFFFFFFFFU;
    md_pd_fix_span_max = 0U;
    md_pd_fix_ph   = 0U;   md_pd_gps_isr_max = 0U;
}

/* Completed-frame ring: last-JEOS ISR writes (the ADC IRQs share priority
 * 3, so writes never nest), app task reads. Free-running indices, same
 * discipline as gps.c's echo ring. A full ring drops the frame — the
 * tick gap tells the host — and counts the overrun (debugger-visible). */
#define MD_FRAME_RING 32U               /* power of two */
static md_frame_t md_frame_ring[MD_FRAME_RING];
static volatile uint32_t md_frame_head = 0U;  /* ISR writes  */
static volatile uint32_t md_frame_tail = 0U;  /* task writes */
volatile uint32_t md_frame_overruns = 0U;

uint8_t md_frame_pop(md_frame_t *out)
{
    uint32_t tail = md_frame_tail;
    if (tail == md_frame_head)
        return 0U;
    *out = md_frame_ring[tail & (MD_FRAME_RING - 1U)];
    md_frame_tail = tail + 1U;
    return 1U;
}

/* Cycles per GPS period — the g/b console keys step through the divisor
 * list below; persisted with the settings (packed into the rx_window
 * record word). The pacer reads this per arm, so a change takes effect
 * within one fix interval. */
volatile uint8_t md_samples_per_period = MD_SAMPLES_PER_GPS_PERIOD;

static const uint8_t md_rate_steps[] = { 1U, 2U, 5U, 10U, 25U };
#define MD_RATE_STEPS (sizeof(md_rate_steps) / sizeof(md_rate_steps[0]))

static uint8_t md_rate_valid(uint32_t sp)
{
    for (uint32_t i = 0U; i < MD_RATE_STEPS; i++)
        if (md_rate_steps[i] == sp)
            return 1U;
    return 0U;
}

static uint32_t md_sample_rate_hz(void)
{
    return 1000U * md_samples_per_period / MD_GPS_PERIOD_MS;
}

/* Sample interval in TIM7 ticks (0.1 ms): 20 ticks at 500 Hz .. 500 at 20. */
static uint32_t md_interval_ticks(void)
{
    return MD_GPS_PERIOD_MS * MD_PACE_TICKS_PER_MS / md_samples_per_period;
}

/* Recompute the raster slot period from the worst channel's timeline and
 * check the sweep fits the sample interval. Applies (md_slot_ticks) and
 * returns 1, or changes nothing and returns 0. The slot period stretches
 * past the 200 µs floor when a channel's tx+bl+rx grows too long for it
 * OR when the requested pulse spacing (md_pulse_ticks) is slower — always
 * reported (info line / rastercfg echo), never truncated. */
static uint8_t md_raster_apply(void)
{
    uint32_t worst = 0U;
    for (uint32_t k = 0U; k < 8U; k++) {
        uint32_t t = (uint32_t)md_ch_tx_us[k] + md_ch_bl_us[k] + md_ch_rx_us[k];
        if (t > worst) worst = t;
    }
    uint32_t ticks = (worst + MD_SLOT_ADC_US + MD_SLOT_MARGIN_US + 99U) / 100U;
    if (ticks < MD_SLOT_TICKS_MIN)
        ticks = MD_SLOT_TICKS_MIN;
    if (ticks < md_pulse_ticks)
        ticks = md_pulse_ticks;
    md_slot_want = (uint8_t)ticks;   /* remembered even when refused: the
                                        raster-limit warn prints the value
                                        that failed the fit, not the one
                                        still applied (self-contradictory
                                        numbers otherwise) */
    if (8U * ticks > md_interval_ticks())
        return 0U;
    md_slot_ticks = (uint8_t)ticks;
    return 1U;
}

/* Would the current slot period still fit at sp samples per GPS period? */
static uint8_t md_raster_rate_ok(uint32_t sp)
{
    return !md_raster
        || 8U * (uint32_t)md_slot_ticks
           <= MD_GPS_PERIOD_MS * MD_PACE_TICKS_PER_MS / sp;
}

/* Seed the per-channel table from the shared globals (legacy settings
 * records, defaults, CLEAR). */
static void md_table_seed(void)
{
    for (uint32_t k = 0U; k < 8U; k++) {
        md_ch_tx_us[k] = (uint8_t)md_tx_pulse_us;
        md_ch_bl_us[k] = (uint8_t)md_blanking_us;
        md_ch_rx_us[k] = (uint8_t)md_rx_window_us;
    }
}

static void md_table_copy(uint8_t *dst, const volatile uint8_t *src)
{
    for (uint32_t k = 0U; k < 8U; k++)
        dst[k] = src[k];
}

static void md_table_restore(volatile uint8_t *dst, const uint8_t *src)
{
    for (uint32_t k = 0U; k < 8U; k++)
        dst[k] = src[k];
}

/* Nudge the selected channel(s) of one table field by delta, clamped.
 * Returns 1 if any value changed. */
static int md_table_adj(volatile uint8_t *tab, int delta,
                        uint32_t lo, uint32_t hi)
{
    int any = 0;
    uint32_t k0 = (md_sel_ch == MD_SEL_ALL) ? 0U : md_sel_ch;
    uint32_t k1 = (md_sel_ch == MD_SEL_ALL) ? 7U : md_sel_ch;
    for (uint32_t k = k0; k <= k1; k++) {
        int32_t v = (int32_t)tab[k] + delta;
        if (v < (int32_t)lo) v = (int32_t)lo;
        if (v > (int32_t)hi) v = (int32_t)hi;
        if ((uint8_t)v != tab[k]) { tab[k] = (uint8_t)v; any = 1; }
    }
    return any;
}

typedef struct {
    ADC_TypeDef *adc;
    uint8_t      ch1, ch2;  /* injected sequence: ch1 then ch2 (both 1..9)  */
    uint8_t      idx;       /* md_adc[idx] = ch1 result, [idx+1] = ch2      */
} md_adc_pair_t;

static const md_adc_pair_t md_adc_pairs[4] = {
    { ADC1, 1, 2, 0 },      /* PA0,  PA1  */
    { ADC2, 3, 4, 2 },      /* PA6,  PA7  */
    { ADC3, 1, 5, 4 },      /* PB1,  PB13 */
    { ADC4, 3, 4, 6 },      /* PB12, PB14 */
};

/* 0x0F = idle/complete; md_adc_kick clears it, each JEOS sets its bit.
 * The three ADC IRQs share priority 3, so they never preempt each other
 * and the read-modify-write below is race-free. */
static volatile uint8_t md_adc_done_mask = 0x0FU;

#define MD_ADC_SMP_47CYC5  4U   /* SMPR code: 47.5 ADC clocks @ 42.5 MHz    */

/* Calibrate, set sampling times, load the injected sequences, enable, and
 * unmask JEOS. CubeMX's HAL_ADC_Init already ran (regulator up, JQDIS=1,
 * independent mode); this owns the rest, per the module's override pattern. */
static void md_adc_init(void)
{
    ADC_HandleTypeDef *hs[4] = { &hadc1, &hadc2, &hadc3, &hadc4 };

    for (uint32_t i = 0; i < 4U; i++) {
        const md_adc_pair_t *p = &md_adc_pairs[i];

        HAL_ADCEx_Calibration_Start(hs[i], ADC_SINGLE_ENDED);

        /* Injected 16x oversampling, no shift: each JDR is the hardware
         * SUM of 16 conversions — max 16*4095 = 65520, so the values
         * still fit uint16_t end-to-end (md_adc[], CSV, daemon). ~2 more
         * effective bits for a ~16x longer sequence (~45 us/pair), which
         * the 2 ms-and-up sample cadence has to spare. Full-register write also
         * evicts anything a debugger poke left behind (JADSTART is 0). */
        p->adc->CFGR2 = ADC_CFGR2_JOVSE | (3U << ADC_CFGR2_OVSR_Pos);

        uint32_t smpr = p->adc->SMPR1;      /* both channels are 1..9        */
        smpr &= ~((7U << (3U * p->ch1)) | (7U << (3U * p->ch2)));
        smpr |=  (MD_ADC_SMP_47CYC5 << (3U * p->ch1))
               | (MD_ADC_SMP_47CYC5 << (3U * p->ch2));
        p->adc->SMPR1 = smpr;

        /* JL=1 → 2 conversions; JEXTEN=0 → software start (JADSTART) */
        p->adc->JSQR = ADC_JSQR_JL_0
                     | ((uint32_t)p->ch1 << ADC_JSQR_JSQ1_Pos)
                     | ((uint32_t)p->ch2 << ADC_JSQR_JSQ2_Pos);

        p->adc->ISR = ADC_ISR_ADRDY;
        p->adc->CR |= ADC_CR_ADEN;
        while (!(p->adc->ISR & ADC_ISR_ADRDY)) {}
        p->adc->ISR = ADC_ISR_JEOS | ADC_ISR_JEOC;
        p->adc->IER |= ADC_IER_JEOSIE;
    }

    /* Below the timers (2), above the GPS UART (6). Handlers live in
     * stm32g4xx_it.c USER CODE 1 — CubeMX does not generate them. */
    HAL_NVIC_SetPriority(ADC1_2_IRQn, 3, 0);
    HAL_NVIC_EnableIRQ(ADC1_2_IRQn);
    HAL_NVIC_SetPriority(ADC3_IRQn, 3, 0);
    HAL_NVIC_EnableIRQ(ADC3_IRQn);
    HAL_NVIC_SetPriority(ADC4_IRQn, 3, 0);
    HAL_NVIC_EnableIRQ(ADC4_IRQn);
}

/* Hot path: start all four injected sequences. The pair JSQRs are
 * rewritten on every kick (legal: JADSTART is clear between cycles, and
 * the previous cycle is complete by the overlap guard) — raster slots
 * reprogram JSQR to a single conversion, so the simultaneous path is
 * self-healing after any mode toggle instead of needing a restore step. */
static inline void md_adc_kick(void)
{
    md_kick_raster = 0U;
    md_adc_done_mask = 0U;
    for (uint32_t i = 0U; i < 4U; i++) {
        const md_adc_pair_t *p = &md_adc_pairs[i];
        p->adc->JSQR = ADC_JSQR_JL_0
                     | ((uint32_t)p->ch1 << ADC_JSQR_JSQ1_Pos)
                     | ((uint32_t)p->ch2 << ADC_JSQR_JSQ2_Pos);
        p->adc->CR |= ADC_CR_JADSTART;
    }
}

/* Raster hot path: convert ONLY the slot's channel (JL=0, one conversion,
 * ~23 µs at 16x oversampling) on the ADC that owns it. The pair-mate
 * belongs to the parked set — its integrator was never reset or gated
 * this slot, so there is nothing meaningful to read. */
static inline void md_adc_kick_one(void)
{
    uint32_t k = md_slot_ch;
    const md_adc_pair_t *p = &md_adc_pairs[k >> 1];
    md_kick_raster = 1U;
    md_adc_done_mask = (uint8_t)(0x0FU & ~(1U << (k >> 1)));
    p->adc->JSQR = (uint32_t)((k & 1U) ? p->ch2 : p->ch1) << ADC_JSQR_JSQ1_Pos;
    p->adc->CR |= ADC_CR_JADSTART;
}

/* ---------------------------------------------------------------------------
 * System status (1 Hz CSV append): PA8 rail monitor + die temperature on
 * ADC5 — intentionally an ADC the detector circuit doesn't use. Blocking
 * injected read of 3 channels (~18 us at 247.5-cycle sampling, task
 * context only). PA8 sees its rail through a 10k series / 1k-to-ground
 * divider (x11). VREFINT is read alongside so VDDA is computed from the
 * factory-calibrated bandgap each time; temp uses TS_CAL1/TS_CAL2 (30 C /
 * 130 C points, both calibrated at VREF+ = 3.0 V).
 * ------------------------------------------------------------------------- */
#define MD_STATUS_DIVIDER    11.0f    /* (10k + 1k) / 1k                    */
#define MD_ADC5_CH_VIN       1U       /* PA8 = ADC5_IN1                     */
#define MD_ADC5_CH_TEMP      4U       /* temp sensor = ADC5_IN4             */
#define MD_ADC5_CH_VREFINT   18U      /* VREFINT = ADC5_IN18                */
#define MD_ADC_SMP_247CYC5   6U       /* temp sensor needs >= 5 us sampling */

static void md_status_init(void)
{
    HAL_ADCEx_Calibration_Start(&hadc5, ADC_SINGLE_ENDED);

    /* Route VREFINT to IN18 (VSENSESEL for the temp sensor was already set
     * by the CubeMX channel config). */
    ADC345_COMMON->CCR |= ADC_CCR_VREFEN;

    ADC5->SMPR1 = (ADC5->SMPR1
                   & ~((7U << (3U * MD_ADC5_CH_VIN))
                     | (7U << (3U * MD_ADC5_CH_TEMP))))
                  | (MD_ADC_SMP_247CYC5 << (3U * MD_ADC5_CH_VIN))
                  | (MD_ADC_SMP_247CYC5 << (3U * MD_ADC5_CH_TEMP));
    ADC5->SMPR2 = (ADC5->SMPR2
                   & ~(7U << (3U * (MD_ADC5_CH_VREFINT - 10U))))
                  | (MD_ADC_SMP_247CYC5 << (3U * (MD_ADC5_CH_VREFINT - 10U)));

    /* Injected sequence: VIN, TEMP, VREFINT; software-triggered (JEXTEN=0) */
    ADC5->JSQR = ADC_JSQR_JL_1                          /* JL=2 -> 3 convs  */
               | (MD_ADC5_CH_VIN     << ADC_JSQR_JSQ1_Pos)
               | (MD_ADC5_CH_TEMP    << ADC_JSQR_JSQ2_Pos)
               | (MD_ADC5_CH_VREFINT << ADC_JSQR_JSQ3_Pos);

    ADC5->ISR = ADC_ISR_ADRDY;
    ADC5->CR |= ADC_CR_ADEN;
    while (!(ADC5->ISR & ADC_ISR_ADRDY)) {}
}

void md_status_read(float *vin_volts, float *temp_c)
{
    ADC5->ISR = ADC_ISR_JEOS | ADC_ISR_JEOC;
    ADC5->CR |= ADC_CR_JADSTART;
    while (!(ADC5->ISR & ADC_ISR_JEOS)) {}              /* ~18 us           */
    uint32_t raw_vin  = ADC5->JDR1;
    uint32_t raw_temp = ADC5->JDR2;
    uint32_t raw_vref = ADC5->JDR3;
    ADC5->ISR = ADC_ISR_JEOS | ADC_ISR_JEOC;

    if (raw_vref == 0U)                                 /* broken bandgap   */
        raw_vref = 1U;

    /* Actual VDDA from the bandgap: cal value was taken at 3.0 V */
    float vdda = 3.0f * (float)(*VREFINT_CAL_ADDR) / (float)raw_vref;

    /* Scale the temp reading into the 3.0 V calibration domain, then
     * interpolate between the two factory points. */
    float ts = (float)raw_temp * vdda / 3.0f;
    *temp_c = 30.0f + (130.0f - 30.0f)
              * (ts - (float)(*TEMPSENSOR_CAL1_ADDR))
              / ((float)(*TEMPSENSOR_CAL2_ADDR) - (float)(*TEMPSENSOR_CAL1_ADDR));

    *vin_volts = (float)raw_vin / 4095.0f * vdda * MD_STATUS_DIVIDER;
}

/* ---------------------------------------------------------------------------
 * Flash settings storage — append-log in the last 4 KB page (page 31 at
 * 0x0801F000; the linker FLASH region is shrunk to 124K so the app image
 * can never grow into it). Each save appends one 32-byte record; the page
 * is erased only when all 128 slots are used, so the ~22 ms single-bank
 * erase stall (CPU can't fetch from flash during erase) almost never
 * happens. Loading takes the last valid record; a blank page = defaults.
 * ------------------------------------------------------------------------- */
#define MD_SETTINGS_PAGE_ADDR  0x0801F000UL
#define MD_SETTINGS_PAGE       31U            /* 4 KB pages, DBANK=0        */
#define MD_SETTINGS_MAGIC      0x3354444DUL   /* 'MDT3' — legacy 32 B       */
#define MD_SETTINGS_MAGIC4     0x3454444DUL   /* 'MDT4' — 64 B, raster      */

typedef struct __attribute__((aligned(8))) {
    uint32_t magic;
    uint32_t blanking_us;          /* bits 23:0 blanking; bits 31:24 held
                                      the retired fire mode — ignored on
                                      load, written 0 (both sets always
                                      fire now)                           */
    uint32_t rx_window_us;         /* bits 7:0 rx window (<= 50); bits
                                      15:8 samples per GPS period (0 =
                                      pre-rate record -> default applies) */
    uint32_t coil_spacing_mm;      /* 0xFFFFFFFF = pre-geometry record     */
    int32_t  coil_offset_fore_mm;  /* array center vs antenna, + forward   */
    int32_t  coil_offset_right_mm; /* + starboard                          */
    uint32_t tx_pulse_us;          /* was the spare word: 0xFFFFFFFF in
                                      older records -> default applies     */
    uint32_t check;                /* ~(XOR of the 7 words above)          */
} md_settings_rec_t;               /* 32 bytes = 4 flash doublewords       */

/* v4 record: the MDT3 layout plus the raster mode flag and the per-channel
 * timing table. Saves always write this; loads accept either magic (the
 * newest valid record of any vintage wins), so a board upgraded from MDT3
 * firmware keeps its tuning. Words 0..6 keep the MDT3 meaning — only the
 * ex-fire-mode bits 31:24 of blanking_us are repurposed for the mode. */
typedef struct __attribute__((aligned(8))) {
    uint32_t magic;                /* 'MDT4'                               */
    uint32_t blanking_us;          /* bits 23:0 blanking; bits 31:24 mode
                                      (0 = all-at-once, 1 = raster)        */
    uint32_t rx_window_us;         /* as MDT3 (rx | samples_per_period<<8) */
    uint32_t coil_spacing_mm;
    int32_t  coil_offset_fore_mm;
    int32_t  coil_offset_right_mm;
    uint32_t tx_pulse_us;
    uint8_t  ch_bl_us[8];          /* raster per-channel table             */
    uint8_t  ch_rx_us[8];
    uint8_t  ch_tx_us[8];
    uint32_t pulse_ticks;          /* requested raster pulse spacing, 0.1 ms
                                      ticks (2..255); pre-pulse records read
                                      erased 0xFFFFFFFF -> default          */
    uint32_t reserved;             /* written erased (0xFFFFFFFF): a future
                                      field reads "not present" in old
                                      records for free, MDT3-style         */
    uint32_t check;                /* ~(XOR of the 15 words above)         */
} md_settings_rec4_t;              /* 64 bytes = 8 flash doublewords       */

_Static_assert(sizeof(md_settings_rec_t)  == 32U, "MDT3 record is 32 bytes");
_Static_assert(sizeof(md_settings_rec4_t) == 64U, "MDT4 record is 64 bytes");

#define MD_SETTINGS_SLOTS  (4096U / sizeof(md_settings_rec_t))
#define MD_SETTINGS_SLOTS4 (4096U / sizeof(md_settings_rec4_t))

static uint32_t md_settings_check_words(const uint32_t *w, uint32_t nwords)
{
    uint32_t x = 0U;
    for (uint32_t i = 0U; i < nwords - 1U; i++)
        x ^= w[i];
    return ~x;
}

static uint32_t md_settings_check(const md_settings_rec_t *r)
{
    return md_settings_check_words((const uint32_t *)r, 8U);
}

static uint32_t md_settings_check4(const md_settings_rec4_t *r)
{
    return md_settings_check_words((const uint32_t *)r, 16U);
}

/* Slot addressing stays in 32-byte units: legacy MDT3 records sit at any
 * 32 B slot, MDT4 records only at even slots (64 B alignment). */
static const md_settings_rec_t *md_settings_slot(uint32_t i)
{
    return (const md_settings_rec_t *)(MD_SETTINGS_PAGE_ADDR
                                       + i * sizeof(md_settings_rec_t));
}

/* A save cut by power loss can leave a doubleword with invalid ECC; any
 * read of it (e.g. the boot-time slot scan) raises an ECC double-error
 * NMI. Without this hook the stock NMI handler hangs forever — a bricked
 * unit. Called from NMI_Handler: if the failing address is inside the
 * settings page, clear the flags, note the fault, and resume (the read
 * returned garbage, which magic/checksum reject); MD_Load_Settings then
 * purges the page. Any other NMI cause returns 0 → original hang. */
static volatile uint32_t md_settings_ecc_fault = 0U;

uint32_t MD_Settings_ECC_NMI(void)
{
    uint32_t eccr = FLASH->ECCR;
    if (!(eccr & (FLASH_ECCR_ECCD | FLASH_ECCR_ECCD2)))
        return 0U;

    /* DBANK=0: ADDR_ECC = byte offset (from flash base) of the failing
     * 128-bit quad word, low 4 bits cleared (RM0440 3.3.2). */
    uint32_t off = eccr & FLASH_ECCR_ADDR_ECC;
    if (off <  (MD_SETTINGS_PAGE_ADDR - FLASH_BASE) ||
        off >= (MD_SETTINGS_PAGE_ADDR - FLASH_BASE) + 4096U)
        return 0U;                     /* ECC fault outside our page       */

    FLASH->ECCR = eccr | FLASH_ECCR_ECCD | FLASH_ECCR_ECCD2;   /* w1c     */
    md_settings_ecc_fault = 1U;
    return 1U;
}

/* Erase the settings page (also the recovery path for ECC faults). */
static void md_settings_erase_page(void)
{
    FLASH_EraseInitTypeDef erase = {
        .TypeErase = FLASH_TYPEERASE_PAGES,
        .Banks     = FLASH_BANK_1,
        .Page      = MD_SETTINGS_PAGE,
        .NbPages   = 1U,
    };
    uint32_t page_err = 0U;
    HAL_FLASH_Unlock();
    __HAL_FLASH_CLEAR_FLAG(FLASH_FLAG_SR_ERRORS);
    (void)HAL_FLASHEx_Erase(&erase, &page_err);
    HAL_FLASH_Lock();
}

void MD_Load_Settings(void)
{
    /* Newest valid record of EITHER vintage wins. Words 0..6 of an MDT4
     * record carry the MDT3 meanings, so `last` reads the shared fields
     * from both; `last4` is non-NULL only when the winner is MDT4. MDT4
     * candidates live at even 32 B slots only (64 B records); a matched
     * one skips the slot holding its second half, whose bytes could
     * otherwise be misread as a record head. */
    const md_settings_rec_t  *last  = NULL;
    const md_settings_rec4_t *last4 = NULL;

    for (uint32_t i = 0U; i < MD_SETTINGS_SLOTS; i++) {
        const md_settings_rec_t *r = md_settings_slot(i);
        if ((i & 1U) == 0U && r->magic == MD_SETTINGS_MAGIC4) {
            const md_settings_rec4_t *r4 = (const md_settings_rec4_t *)r;
            if (r4->check == md_settings_check4(r4)) {
                last  = r;
                last4 = r4;
                i++;                         /* skip the record's tail half  */
            }
            continue;
        }
        if (r->magic == MD_SETTINGS_MAGIC && r->check == md_settings_check(r)) {
            last  = r;                       /* newest valid record wins     */
            last4 = NULL;
        }
    }

    if (md_settings_ecc_fault) {
        /* An interrupted save left invalid ECC somewhere in the page (the
         * scan's NMIs were absorbed above). Purge it and run defaults. */
        md_settings_ecc_fault = 0U;
        md_settings_erase_page();
        last = NULL;
        printf("# settings page had ECC fault -- erased, using defaults\r\n");
    }

    if (last) {
        /* Clamp to the same limits the console enforces (16-bit ARR at
         * 170 MHz ticks) in case the record came from other firmware. */
        uint32_t bl = last->blanking_us & 0x00FFFFFFU;
        md_blanking_us  = (bl <= MD_BLANKING_MAX_US)
                          ? bl : MD_BLANKING_MAX_US;
        uint32_t rxw = last->rx_window_us & 0xFFU;
        uint32_t sp  = (last->rx_window_us >> 8) & 0xFFU;
        md_rx_window_us = (rxw >= 1U && rxw <= MD_RX_WINDOW_MAX_US)
                          ? rxw : MD_RX_WINDOW_US;
        /* 0 = record predates the sample rate; anything not in the step
         * list means foreign firmware — the default applies either way. */
        md_samples_per_period = md_rate_valid(sp)
                          ? (uint8_t)sp : (uint8_t)MD_SAMPLES_PER_GPS_PERIOD;
        /* Older records carry erased 0xFFFFFFFF in this (ex-spare) word —
         * out of range, so the compile-time default applies. */
        md_tx_pulse_us  = (last->tx_pulse_us >= MD_TX_PULSE_MIN_US &&
                           last->tx_pulse_us <= MD_TX_PULSE_MAX_US)
                          ? last->tx_pulse_us : MD_TX_PULSE_US;
        /* Records saved before the geometry fields existed have erased
         * 0xFFFFFFFF in coil_spacing_mm — keep all-default geometry then
         * (the offsets would otherwise read as -1 mm, not 0). */
        if (last->coil_spacing_mm != 0xFFFFFFFFU) {
            md_coil_spacing_mm =
                (last->coil_spacing_mm >= MD_COIL_SPACING_MM_MIN &&
                 last->coil_spacing_mm <= MD_COIL_SPACING_MM_MAX)
                ? last->coil_spacing_mm : MD_COIL_SPACING_MM_DEFAULT;
            md_coil_offset_fore_mm =
                (last->coil_offset_fore_mm  >= -MD_COIL_OFFSET_MM_LIMIT &&
                 last->coil_offset_fore_mm  <=  MD_COIL_OFFSET_MM_LIMIT)
                ? last->coil_offset_fore_mm : 0;
            md_coil_offset_right_mm =
                (last->coil_offset_right_mm >= -MD_COIL_OFFSET_MM_LIMIT &&
                 last->coil_offset_right_mm <=  MD_COIL_OFFSET_MM_LIMIT)
                ? last->coil_offset_right_mm : 0;
        }
        if (last4) {
            /* Per-channel table + mode, each value re-clamped like the
             * shared fields (a foreign record must not arm a slot with an
             * out-of-range timeline). */
            for (uint32_t k = 0U; k < 8U; k++) {
                md_ch_bl_us[k] = (last4->ch_bl_us[k] <= MD_BLANKING_MAX_US)
                                 ? last4->ch_bl_us[k] : (uint8_t)MD_BLANKING_MAX_US;
                md_ch_rx_us[k] = (last4->ch_rx_us[k] >= 1U &&
                                  last4->ch_rx_us[k] <= MD_RX_WINDOW_MAX_US)
                                 ? last4->ch_rx_us[k] : (uint8_t)MD_RX_WINDOW_US;
                md_ch_tx_us[k] = (last4->ch_tx_us[k] >= MD_TX_PULSE_MIN_US &&
                                  last4->ch_tx_us[k] <= MD_TX_PULSE_MAX_US)
                                 ? last4->ch_tx_us[k] : (uint8_t)MD_TX_PULSE_US;
            }
            md_raster = (((last4->blanking_us >> 24) & 0xFFU) == 1U) ? 1U : 0U;
            /* Requested pulse spacing: erased 0xFFFFFFFF in pre-pulse
             * records (and anything out of range) falls back to "as fast
             * as the timings allow". */
            md_pulse_ticks = (last4->pulse_ticks >= MD_SLOT_TICKS_MIN &&
                              last4->pulse_ticks <= 255U)
                             ? (uint8_t)last4->pulse_ticks
                             : (uint8_t)MD_SLOT_TICKS_MIN;
        } else {
            md_table_seed();                 /* legacy record: table = globals */
            md_raster = 0U;
            md_pulse_ticks = MD_SLOT_TICKS_MIN;
        }
        if (md_raster && !md_raster_apply()) {
            /* Foreign/stale combo: sweep doesn't fit the sample interval.
             * Fall back to all-at-once rather than guessing which knob to
             * clamp; the table survives for after a rate change. */
            md_raster = 0U;
            printf("# raster from saved settings does not fit the sample rate -- starting in all mode\r\n");
        } else if (!md_raster) {
            (void)md_raster_apply();         /* best-effort slot period      */
        }
        printf("# settings loaded: blanking=%luus  rx_window=%luus  tx_pulse=%luus  coil_spacing=%lumm  sample_rate=%luHz\r\n",
               md_blanking_us, md_rx_window_us, md_tx_pulse_us, md_coil_spacing_mm,
               md_sample_rate_hz());
    } else {
        /* Nothing valid in flash (new board, or the page was just purged
         * after an ECC fault): persist the compile-time defaults so the
         * unit always carries a valid record. CLEAR re-writes them on demand. */
        md_table_seed();
        (void)md_raster_apply();
        printf("# no saved settings -- writing defaults: blanking=%luus  rx_window=%luus  tx_pulse=%luus  coil_spacing=%lumm  sample_rate=%luHz\r\n",
               md_blanking_us, md_rx_window_us, md_tx_pulse_us, md_coil_spacing_mm,
               md_sample_rate_hz());
        MD_Save_Settings();
    }
}

void MD_Save_Settings(void)
{
    /* Hold the pacer off so no cycle STARTS mid-save (flash ops stall the
     * bus and would defer the timeline's ADC kick). A fire that lands
     * during the save pends and runs right after re-enable. Harmless
     * before md_pace_init (first-boot default write): nothing pends. */
    HAL_NVIC_DisableIRQ(TIM7_DAC_IRQn);

    /* A cycle started just before the disable may still be in flight; the
     * flash stall would defer its ADC kick too, sampling integrators that
     * drooped for the whole operation (~22 ms on a page erase). Wait it
     * out: a full cycle is well under 1 ms, the tick bound is a safety
     * valve. The TIM1/TIM8 UIF terms cover a kick that is pended but not
     * yet taken (TIM8 kicks Set B slots in raster mode). */
    uint32_t t0 = HAL_GetTick();
    while ((((TIM2->CR1 | TIM3->CR1 | TIM1->CR1 | TIM8->CR1) & TIM_CR1_CEN)
            || (TIM1->SR & TIM_SR_UIF) || (TIM8->SR & TIM_SR_UIF)
            || md_adc_done_mask != 0x0FU)
           && (HAL_GetTick() - t0) < 2U) {}

    /* A raster sweep frozen mid-way (its remaining slots pend behind the
     * disabled pacer) resumes with a flash-op-sized hole in its slot
     * spacing — drop the frame instead of publishing one with lying skew.
     * The pacer IRQ is off, so md_sweep_ok is ours to write here. */
    if (md_raster && md_slot != 0U)
        md_sweep_ok = 0U;

    /* First fully-erased 64 B (even-32B-slot-aligned) region; legacy 32 B
     * records occupying half a region make it non-erased, so mixed pages
     * from an MDT3-era board just appear fuller. Page full -> erase. */
    uint32_t slot = MD_SETTINGS_SLOTS;
    for (uint32_t i = 0U; i < MD_SETTINGS_SLOTS && slot == MD_SETTINGS_SLOTS;
         i += 2U) {
        const uint32_t *w = (const uint32_t *)md_settings_slot(i);
        uint32_t j;
        for (j = 0U; j < 16U; j++)
            if (w[j] != 0xFFFFFFFFU)
                break;
        if (j == 16U)
            slot = i;
    }

    md_settings_rec4_t rec;
    memset(&rec, 0xFF, sizeof(rec));
    rec.magic                = MD_SETTINGS_MAGIC4;
    rec.blanking_us          = md_blanking_us
                             | ((uint32_t)(md_raster ? 1U : 0U) << 24);
    rec.rx_window_us         = md_rx_window_us
                             | ((uint32_t)md_samples_per_period << 8);
    rec.tx_pulse_us          = md_tx_pulse_us;
    rec.coil_spacing_mm      = md_coil_spacing_mm;
    rec.coil_offset_fore_mm  = md_coil_offset_fore_mm;
    rec.coil_offset_right_mm = md_coil_offset_right_mm;
    for (uint32_t k = 0U; k < 8U; k++) {
        rec.ch_bl_us[k] = md_ch_bl_us[k];
        rec.ch_rx_us[k] = md_ch_rx_us[k];
        rec.ch_tx_us[k] = md_ch_tx_us[k];
    }
    rec.pulse_ticks          = md_pulse_ticks;
    rec.check                = md_settings_check4(&rec);

    HAL_FLASH_Unlock();

    /* Clear stale SR error flags — notably OPTVERR, which the option-byte
     * loader can leave set at reset; the HAL's entry check would otherwise
     * fail the first program/erase after boot. */
    __HAL_FLASH_CLEAR_FLAG(FLASH_FLAG_SR_ERRORS);

    if (slot == MD_SETTINGS_SLOTS) {
        FLASH_EraseInitTypeDef erase = {
            .TypeErase = FLASH_TYPEERASE_PAGES,
            .Banks     = FLASH_BANK_1,
            .Page      = MD_SETTINGS_PAGE,
            .NbPages   = 1U,
        };
        uint32_t page_err = 0U;
        if (HAL_FLASHEx_Erase(&erase, &page_err) != HAL_OK) {
            HAL_FLASH_Lock();
            HAL_NVIC_EnableIRQ(TIM7_DAC_IRQn);
            printf("# save FAILED: page erase error 0x%08lx\r\n", page_err);
            return;
        }
        slot = 0U;
    }

    HAL_StatusTypeDef st = HAL_OK;
    const uint64_t *src = (const uint64_t *)&rec;
    uint32_t dst = MD_SETTINGS_PAGE_ADDR + slot * sizeof(md_settings_rec_t);
    for (uint32_t i = 0U; i < 8U && st == HAL_OK; i++)
        st = HAL_FLASH_Program(FLASH_TYPEPROGRAM_DOUBLEWORD,
                               dst + 8U * i, src[i]);

    /* HAL_FLASHEx_Erase flushes the ART caches but HAL_FLASH_Program does
     * not: without this, the readback below (and the next save's free-slot
     * scan) can see stale erased 0xFFs from the data cache — the scan would
     * then re-program a written doubleword, which G4 ECC forbids. */
    __HAL_FLASH_DATA_CACHE_DISABLE();
    __HAL_FLASH_DATA_CACHE_RESET();
    __HAL_FLASH_DATA_CACHE_ENABLE();

    HAL_FLASH_Lock();
    HAL_NVIC_EnableIRQ(TIM7_DAC_IRQn);
    md_pace_diag_reset();   /* the ~22 ms hold above is a known, user-made
                               outlier — keep it out of the 'P' statistics */

    const md_settings_rec4_t *r = (const md_settings_rec4_t *)md_settings_slot(slot);
    if (st == HAL_OK && r->magic == MD_SETTINGS_MAGIC4
        && r->check == md_settings_check4(r))
        printf("# saved (slot %lu/%u): blanking=%luus  rx_window=%luus  tx_pulse=%luus  coil_spacing=%lumm  sample_rate=%luHz\r\n",
               slot / 2U, (unsigned)MD_SETTINGS_SLOTS4,
               md_blanking_us, md_rx_window_us, md_tx_pulse_us, md_coil_spacing_mm,
               md_sample_rate_hz());
    else
        printf("# save FAILED: program/verify at slot %lu\r\n", slot / 2U);
}

/* ---------------------------------------------------------------------------
 * 'I' info line: everything the daemon stamps into a study header. One
 * space-separated key=value line, parse-friendly; "?" marks a value the
 * GPS module never reported. Task context only (printf).
 *
 * The identity strings are written by the USART2 ISR (gps_capture_id) and
 * the deferred 'I' path prints on a deadline — i.e. possibly while a late
 * reply is landing — so they are snapshotted with that ISR masked (sub-µs
 * for 128 bytes; a pended char-match is serviced right after, DMA keeps
 * filling). The ISR runs to completion before the task resumes, so the
 * task can never see a half-written string; the mask only makes the
 * snapshot deterministic (a reply landing mid-copy would otherwise read
 * as "?" for that one print). Cheap insurance, not a bug fix.
 *
 * gps_id "none": the module answered $PQTMVERNO but not $PQTMUNIQID on
 * MD_UNIQID_GIVEUP consecutive deferred 'I' replies — it has no unique ID
 * (the boot config already treats the query as optional). Reported as a
 * value so the daemon's header completes and its retry stops; "?" stays
 * the marker for "not heard yet".
 * ------------------------------------------------------------------------- */
#define MD_UNIQID_GIVEUP 2U
static uint8_t md_uniqid_misses = 0U;   /* deferred replies with ver, no id */

void md_print_info(void)
{
    char ver[sizeof gps_version_str];
    char uid[sizeof gps_uniqid_str];
    HAL_NVIC_DisableIRQ(USART2_IRQn);
    memcpy(ver, gps_version_str, sizeof ver);
    memcpy(uid, gps_uniqid_str, sizeof uid);
    HAL_NVIC_EnableIRQ(USART2_IRQn);
    ver[sizeof ver - 1U] = '\0';
    uid[sizeof uid - 1U] = '\0';

    printf("# info fw=%s gps_ver=%s gps_id=%s gps_cfg=%s"
           " blanking_us=%lu rx_window_us=%lu tx_pulse_us=%lu"
           " coil_spacing_mm=%lu coil_offset_fore_mm=%ld coil_offset_right_mm=%ld"
           " sample_rate_hz=%lu adc_oversample=16 adc=PA0,PA1,PA6,PA7,PB1,PB13,PB12,PB14"
           " detector_mode=%s slot_us=%u pulse_us=%u"
           " bl8=%u,%u,%u,%u,%u,%u,%u,%u"
           " rx8=%u,%u,%u,%u,%u,%u,%u,%u"
           " tx8=%u,%u,%u,%u,%u,%u,%u,%u\r\n",
           FW_GIT_HASH,
           ver[0] ? ver : "?",
           uid[0] ? uid : (md_uniqid_misses >= MD_UNIQID_GIVEUP ? "none" : "?"),
           gps_config_state(),   /* boot|resent|pending|noreply|silent — did the
                                    module take its config burst (gps.c) */
           md_blanking_us, md_rx_window_us, md_tx_pulse_us,
           md_coil_spacing_mm,
           (long)md_coil_offset_fore_mm, (long)md_coil_offset_right_mm,
           md_sample_rate_hz(),
           md_raster ? "raster" : "all",
           (unsigned)md_slot_ticks * 100U,
           (unsigned)md_pulse_ticks * 100U,
           md_ch_bl_us[0], md_ch_bl_us[1], md_ch_bl_us[2], md_ch_bl_us[3],
           md_ch_bl_us[4], md_ch_bl_us[5], md_ch_bl_us[6], md_ch_bl_us[7],
           md_ch_rx_us[0], md_ch_rx_us[1], md_ch_rx_us[2], md_ch_rx_us[3],
           md_ch_rx_us[4], md_ch_rx_us[5], md_ch_rx_us[6], md_ch_rx_us[7],
           md_ch_tx_us[0], md_ch_tx_us[1], md_ch_tx_us[2], md_ch_tx_us[3],
           md_ch_tx_us[4], md_ch_tx_us[5], md_ch_tx_us[6], md_ch_tx_us[7]);
}

/* 'P' pacer diagnostics — one '# pace ...' line, then the window resets.
 * ivl_us: the configured sample interval (sweep-to-sweep in raster).
 * fires / skips: cycles (sweeps) started / starts refused by the overlap
 * guard — per slot in raster, so skips can exceed fires there.
 * dev_max_us / jit_max_us: worst |measured - ivl_us| and worst change
 * between consecutive intervals, stamped at the cycle's CEN write — what
 * the coils actually saw. dev_max_us carries a constant floor: the re-arm
 * resets TIM7's counter AFTER the cycle start, so every interval is
 * nominal plus the ISR's own entry-to-arm time (a few µs at -O0 in all
 * mode; ~8x that in raster, one per slot re-arm); it is a true
 * measurement, not jitter. jit_max_us cancels that constant and is the
 * jitter figure. fix_span_us=min/max: valid-GGA-to-GGA spacing
 * at parse end, i.e. the GPS module's own arrival jitter (the pre-2026-09
 * firmware applied exactly this to the pacer as interval stretches).
 * fix_ph_us: where the last GGA fell after a fire (sweeps 0..ivl_us as
 * the free-running pacer and the GPS clock slide past each other; only a
 * refused start leaves it stale enough to read past ivl_us).
 * gps_isr_max_us: longest NMEA parse inside the USART2 ISR. Token names
 * deliberately match none of the daemon's echo patterns (blanking=,
 * tx_pulse=, coil_spacing=, sample_rate=, detector_mode=). */
static void md_print_pace(void)
{
    uint32_t span_min = md_pd_fix_span_min;
    if (span_min == 0xFFFFFFFFU)
        span_min = 0U;
    printf("# pace det=%s ivl_us=%lu fires=%lu skips=%lu dev_max_us=%lu jit_max_us=%lu"
           " fix_n=%lu fix_span_us=%lu/%lu fix_ph_us=%lu gps_isr_max_us=%lu\r\n",
           md_raster ? "raster" : "all",
           md_interval_ticks() * 100U,
           md_pd_fires, md_pd_skips, md_pd_dev_max, md_pd_jit_max,
           md_pd_fix_n, span_min, md_pd_fix_span_max, md_pd_fix_ph,
           md_pd_gps_isr_max);
    md_pace_diag_reset();
}

/* Raster-state echo — printed on any mode/selection/table change. Same
 * token names as the info line (the daemon tracks them as <key>_current
 * and flags mid-study drift), plus ch= for the UI's selector state. The
 * legacy '# blanking=..' echo keys are deliberately absent: those are the
 * all-at-once globals, unchanged by raster edits, and reusing their names
 * here would spam the daemon's drift tracking. */
static void md_print_rastercfg(void)
{
    char sel[4] = "all";
    if (md_sel_ch != MD_SEL_ALL) {
        sel[0] = (char)('0' + md_sel_ch);
        sel[1] = '\0';
    }
    printf("# rastercfg detector_mode=%s slot_us=%u pulse_us=%u ch=%s"
           " bl8=%u,%u,%u,%u,%u,%u,%u,%u"
           " rx8=%u,%u,%u,%u,%u,%u,%u,%u"
           " tx8=%u,%u,%u,%u,%u,%u,%u,%u\r\n",
           md_raster ? "raster" : "all",
           (unsigned)md_slot_ticks * 100U,
           (unsigned)md_pulse_ticks * 100U, sel,
           md_ch_bl_us[0], md_ch_bl_us[1], md_ch_bl_us[2], md_ch_bl_us[3],
           md_ch_bl_us[4], md_ch_bl_us[5], md_ch_bl_us[6], md_ch_bl_us[7],
           md_ch_rx_us[0], md_ch_rx_us[1], md_ch_rx_us[2], md_ch_rx_us[3],
           md_ch_rx_us[4], md_ch_rx_us[5], md_ch_rx_us[6], md_ch_rx_us[7],
           md_ch_tx_us[0], md_ch_tx_us[1], md_ch_tx_us[2], md_ch_tx_us[3],
           md_ch_tx_us[4], md_ch_tx_us[5], md_ch_tx_us[6], md_ch_tx_us[7]);
}

/* Console key map — printed at boot so the bindings are on screen for
 * anyone at the console. Deliberately no 'key=value' tokens, so the
 * daemon's info/echo parsers can never match these lines. */
void md_print_keys(void)
{
    printf("# keys: a/z blanking +-1us (0..200)    s/x rx window +-1us (1..50)\r\n"
           "# keys: f/v tx pulse +-1us (10..120)   d/c coil spacing +-10mm (50..5000)\r\n"
           "# keys: g/b sample rate up/down (20/40/100/200/500 Hz)\r\n"
           "# keys: r raster/all mode   0-7 select channel, 8 selects all\r\n"
           "# keys: (raster: a/z s/x f/v edit the selected channel's slot timing)\r\n"
           "# keys: h/n raster pulse spacing faster/slower (200us..25ms list)\r\n"
           "# keys: SAVE+enter save settings   CLEAR+enter restore defaults+save\r\n"
           "# keys: I info   G gps passthrough   P pacer diagnostics (resets window)\r\n");
}

/* Force-restore compile-time defaults and persist them (the word-gated
 * CLEAR command — was the single-key 'D'). */
static void md_restore_defaults(void)
{
    /* Mode OFF before the rate write: the pacer IRQ is still live here (it
     * only stops inside MD_Save_Settings), and its sweep-wrap arm computes
     * interval - 7*slot_ticks under the fit invariant that raster mode
     * maintains. An expiry landing between a new (higher) rate and the
     * raster clear would see a shrunken interval with the old slot_ticks
     * and underflow that subtraction (16-bit ARR truncation -> multi-
     * second stall on a GPS-less bench). Raster cleared first, the same
     * expiry just runs one simultaneous cycle at the old cadence. */
    md_raster               = 0U;
    md_sel_ch               = MD_SEL_ALL;
    md_blanking_us          = MD_BLANKING_US;
    md_rx_window_us         = MD_RX_WINDOW_US;
    md_tx_pulse_us          = MD_TX_PULSE_US;
    md_coil_spacing_mm      = MD_COIL_SPACING_MM_DEFAULT;
    md_coil_offset_fore_mm  = 0;
    md_coil_offset_right_mm = MD_COIL_OFFSET_RIGHT_MM_DEFAULT;
    md_samples_per_period   = MD_SAMPLES_PER_GPS_PERIOD;
    md_pulse_ticks          = MD_SLOT_TICKS_MIN;
    md_table_seed();
    (void)md_raster_apply();
    printf("# defaults restored\r\n");
    /* CLEAR is a mode + selection + table change like any other — without
     * this echo the daemon's <key>_current / raster_sel meta (and so the
     * raw view's panel) would keep describing the pre-CLEAR raster state:
     * the saved banner below carries only the legacy global tokens. */
    md_print_rastercfg();
    MD_Save_Settings();
}

/* One keyword-matcher step. Returns 1 if the byte advanced (or restarted)
 * the word — consumed, don't treat it as a key. *pos == len means the full
 * word has been seen; the caller checks the NEXT byte for Enter. */
static int md_word_step(const char *word, uint32_t len, uint32_t *pos,
                        uint8_t ch)
{
    if (*pos < len && ch == (uint8_t)word[*pos]) { (*pos)++; return 1; }
    if (*pos > 0U) {
        *pos = (ch == (uint8_t)word[0]) ? 1U : 0U;
        return (*pos != 0U) ? 1 : 0;
    }
    return 0;
}

/* ---------------------------------------------------------------------------
 * 'I' with the GPS identity still unknown: re-ask the module first, print
 * once both replies have landed or MD_INFO_WAIT_MS has passed. The GPS
 * powers up slightly after the MCU, so the boot-time query in
 * gps_send_config can go unanswered while GGA flows fine; the daemon's 'I'
 * at connect arrives long after the module is up, so asking again there
 * fills the header (2026-09-20). Deferred, never blocking: the frame ring
 * holds MD_FRAME_RING = 32 frames — 64 ms at 500 Hz — so a wait inside the
 * key handler would drop frames. md_info_poll runs from every console
 * poll (task loop, ~1 ms period). A second 'I' while one is pending is
 * folded into it: one answer per outstanding request, within the daemon's
 * 2 s handshake wait either way. Identity known: prints at once, as before.
 * Settled = known, or the module has proven it has no unique ID (version
 * answered, ID not, MD_UNIQID_GIVEUP deferred replies in a row) — then 'I'
 * stops re-asking and reports gps_id=none (see md_print_info).
 * ------------------------------------------------------------------------- */
#define MD_INFO_WAIT_MS 500U
static uint8_t  md_info_pending  = 0U;
static uint32_t md_info_deadline = 0U;

static int md_identity_settled(void)
{
    return gps_identity_known() ||
           (gps_version_str[0] != '\0' && md_uniqid_misses >= MD_UNIQID_GIVEUP);
}

static void md_info_request(void)
{
    if (md_identity_settled()) {
        md_print_info();
        return;
    }
    if (!md_info_pending) {
        gps_query_identity();
        md_info_deadline = HAL_GetTick() + MD_INFO_WAIT_MS;
        md_info_pending  = 1U;
    }
}

static void md_info_poll(void)
{
    if (!md_info_pending)
        return;
    if (gps_identity_known()) {
        md_info_pending = 0U;
        md_print_info();
    } else if ((int32_t)(HAL_GetTick() - md_info_deadline) >= 0) {
        md_info_pending = 0U;
        if (gps_version_str[0] != '\0' && md_uniqid_misses < MD_UNIQID_GIVEUP)
            md_uniqid_misses++;     /* version came, ID did not: strike */
        md_print_info();            /* "?" for whatever the module still owes */
    }
}

/* ---------------------------------------------------------------------------
 * Console: poll USART1 RX from the task loop (detector2 pattern — direct
 * register access, no HAL receive state machine to wedge, no ISR). Drain
 * everything each poll so held keys adjust smoothly; print once.
 *
 * Upper clamps (MD_*_MAX_US) are new on this board — see their definition.
 * ------------------------------------------------------------------------- */
void md_console_poll(void)
{
    USART1->ICR = USART_ICR_ORECF | USART_ICR_FECF
                | USART_ICR_NECF | USART_ICR_PECF;

    int changed = 0;
    int geom_changed = 0;
    int tx_changed = 0;
    int rate_changed = 0;
    int ras_changed = 0;
    int ras_warn = 0;
    /* The warn's operands, SNAPSHOT at the refusal that set ras_warn: a
     * later key in the same drain (a successful apply, a rate change)
     * moves md_slot_want / md_interval_ticks(), and a drain-end print
     * reading them live can pair numbers from two different events —
     * even numbers that satisfy the constraint the warn reports. */
    uint32_t ras_warn_slot = 0U;  /* slot-period operand (ticks)          */
    uint32_t ras_warn_ivl  = 0U;  /* interval operand (ticks) — the
                                     REQUESTED one on a rate refusal      */
    /* Flash writes are word-gated: SAVE+Enter saves, CLEAR+Enter restores
     * defaults and saves. A single stray byte (RX crosstalk from the host's
     * other data line lands as valid-looking key bytes) can never commit to
     * flash. Matcher state is static — words may arrive split across polls.
     * Both matchers step on every byte; a byte neither uses falls through
     * to normal key handling, so tuning keys stay live mid-word. */
    static const char SAVE_WORD[]  = "SAVE";
    static const char CLEAR_WORD[] = "CLEAR";
    static uint32_t save_pos = 0U, clear_pos = 0U;
    while (USART1->ISR & USART_ISR_RXNE) {
        uint8_t ch = (uint8_t)(USART1->RDR & 0xFFU);
        if (save_pos == 4U) {           /* full SAVE seen: want Enter */
            save_pos = 0U;
            if (ch == '\r' || ch == '\n') {
                MD_Save_Settings();
                clear_pos = 0U;
                continue;
            }                           /* not Enter: byte re-enters below */
        }
        if (clear_pos == 5U) {          /* full CLEAR seen: want Enter */
            clear_pos = 0U;
            if (ch == '\r' || ch == '\n') {
                md_restore_defaults();
                save_pos = 0U;
                continue;
            }
        }
        {
            int used = md_word_step(SAVE_WORD,  4U, &save_pos,  ch);
            used    |= md_word_step(CLEAR_WORD, 5U, &clear_pos, ch);
            if (used)
                continue;
        }
        if (ch == 'a' || ch == 'z' || ch == 's' || ch == 'x'
            || ch == 'f' || ch == 'v') {
            if (md_raster) {
                /* Route the edit to the per-channel table (selected channel,
                 * or all 8 in lockstep). An increase that would stretch the
                 * sweep past the sample interval is reverted whole — the
                 * snapshot matters for 'all' edits, where clamped channels
                 * must not walk on a naive undo. */
                int up = (ch == 'a' || ch == 's' || ch == 'f');
                volatile uint8_t *tab;
                uint32_t lo, hi;
                if (ch == 'a' || ch == 'z') {
                    tab = md_ch_bl_us; lo = 0U; hi = MD_BLANKING_MAX_US;
                } else if (ch == 's' || ch == 'x') {
                    tab = md_ch_rx_us; lo = 1U; hi = MD_RX_WINDOW_MAX_US;
                } else {
                    tab = md_ch_tx_us; lo = MD_TX_PULSE_MIN_US; hi = MD_TX_PULSE_MAX_US;
                }
                uint8_t snap[8];
                md_table_copy(snap, tab);
                /* Same bracket + sweep-drop as the h/n path: a 1 µs edit
                 * that crosses a 100 µs tick boundary changes
                 * md_slot_ticks under the pacer's per-slot re-arms —
                 * mixed spacing in one published frame otherwise. Most
                 * edits DON'T move the ticks, so gate the drop on an
                 * actual change (no frame tax per keypress). The adj runs
                 * INSIDE the bracket too: md_start_slot reads the live
                 * table per slot, so a pacer expiry racing the write
                 * could otherwise fire one slot with a refused,
                 * about-to-be-reverted timing that no echo ever reports. */
                HAL_NVIC_DisableIRQ(TIM7_DAC_IRQn);
                if (md_table_adj(tab, up ? 1 : -1, lo, hi)) {
                    uint8_t old_ticks = md_slot_ticks;
                    if (md_raster_apply()) {
                        if (md_slot_ticks != old_ticks && md_slot != 0U) {
                            md_sweep_ok = 0U;
                            /* The slots still to fire re-arm at the new
                             * spacing, so this one sweep interval is off
                             * by (slots fired)*(old-new) — user-made, so
                             * keep it out of the 'P' window like g/b do. */
                            md_pace_diag_reset();
                        }
                        ras_changed = 1;
                    } else {
                        md_table_restore(tab, snap);
                        ras_warn = 1;
                        ras_warn_slot = md_slot_want;
                        ras_warn_ivl  = md_interval_ticks();
                    }
                }
                HAL_NVIC_EnableIRQ(TIM7_DAC_IRQn);
            }
            else if (ch == 'a') { if (md_blanking_us < MD_BLANKING_MAX_US) md_blanking_us += 1U;         changed = 1; }
            else if (ch == 'z') { md_blanking_us  = (md_blanking_us  > 1U) ? md_blanking_us - 1U : 0U;   changed = 1; }
            else if (ch == 's') { if (md_rx_window_us < MD_RX_WINDOW_MAX_US) md_rx_window_us += 1U;      changed = 1; }
            else if (ch == 'x') { md_rx_window_us = (md_rx_window_us > 1U) ? md_rx_window_us - 1U : 1U;  changed = 1; }
            else if (ch == 'f') { if (md_tx_pulse_us < MD_TX_PULSE_MAX_US) md_tx_pulse_us += 1U;         tx_changed = 1; }
            else                { if (md_tx_pulse_us > MD_TX_PULSE_MIN_US) md_tx_pulse_us -= 1U;         tx_changed = 1; }
        }
        else if (ch == 'd') { if (md_coil_spacing_mm < MD_COIL_SPACING_MM_MAX) md_coil_spacing_mm += 10U; geom_changed = 1; }
        else if (ch == 'c') { if (md_coil_spacing_mm > MD_COIL_SPACING_MM_MIN) md_coil_spacing_mm -= 10U; geom_changed = 1; }
        else if (ch == 'g' || ch == 'b') {
            /* Step through the divisor list — the pacer picks the new
             * interval up at its next arm (one transitional interval; the
             * 'P' window is reset so it doesn't read as jitter). In
             * raster mode a step whose interval can't hold the sweep is
             * refused (the echo still confirms the unchanged rate). */
            uint32_t i = 0U;
            while (i < MD_RATE_STEPS - 1U && md_rate_steps[i] != md_samples_per_period)
                i++;
            uint32_t ni = i;
            if (ch == 'g' && i < MD_RATE_STEPS - 1U) ni = i + 1U;
            else if (ch == 'b' && i > 0U) ni = i - 1U;
            if (ni != i && !md_raster_rate_ok(md_rate_steps[ni])) {
                /* The failing pair here is (current slot, REQUESTED
                 * interval) — no apply runs. */
                ras_warn_slot = md_slot_ticks;
                ras_warn_ivl  = MD_GPS_PERIOD_MS * MD_PACE_TICKS_PER_MS
                                / md_rate_steps[ni];
                ras_warn = 1;
            } else {
                md_samples_per_period = md_rate_steps[ni];
                md_pace_diag_reset();
            }
            rate_changed = 1;
        }
        else if (ch == 'h' || ch == 'n') {
            /* Step the requested pulse spacing: 'h' faster (shorter
             * period), 'n' slower. Nearest-in-direction walk so an
             * off-list value from a foreign record still steps sanely.
             * Live in both modes (no lockout): in all mode the apply is
             * a best-effort slot preview — 'r' re-checks the fit anyway. */
            uint8_t cur = md_pulse_ticks, nv = cur;
            if (ch == 'h') {
                for (uint32_t i = MD_PULSE_STEPS; i-- > 0U;)
                    if (md_pulse_steps[i] < cur) { nv = md_pulse_steps[i]; break; }
            } else {
                for (uint32_t i = 0U; i < MD_PULSE_STEPS; i++)
                    if (md_pulse_steps[i] > cur) { nv = md_pulse_steps[i]; break; }
            }
            if (nv != cur) {
                /* The pacer re-reads md_slot_ticks at every per-slot arm,
                 * so an apply landing mid-sweep gives the remaining slots
                 * a different spacing than the fired ones — the frame
                 * would publish with lying skew (the hazard the save path
                 * guards). The IRQ-off bracket makes apply + sweep-drop
                 * atomic against the pacer: without it a sweep START can
                 * slip between a md_slot==0 guard read and the ticks
                 * write and still mix spacings. Sub-µs with IRQs off (a
                 * pended expiry just runs after — 100 µs ticks dwarf it);
                 * the save path holds the same bracket for milliseconds.
                 * Drop only AFTER a successful apply: a refused step
                 * changes nothing, so the in-flight sweep is still good.
                 * The md_slot 0 guard (as in MD_Save_Settings) spares the
                 * slot-7 conversion publishing across the wrap. */
                HAL_NVIC_DisableIRQ(TIM7_DAC_IRQn);
                md_pulse_ticks = nv;
                uint8_t old_ticks = md_slot_ticks;
                if (md_raster_apply()) {
                    if (md_raster && md_slot != 0U) {
                        md_sweep_ok = 0U;
                        if (md_slot_ticks != old_ticks)
                            md_pace_diag_reset();   /* one odd sweep
                                                       interval, user-made */
                    }
                    ras_changed = 1;
                } else if (md_raster) {
                    md_pulse_ticks = cur;  /* sweep wouldn't fit the interval */
                    ras_warn = 1;
                    ras_warn_slot = md_slot_want;
                    ras_warn_ivl  = md_interval_ticks();
                } else {
                    ras_changed = 1;    /* all mode: best-effort, echo anyway */
                }
                HAL_NVIC_EnableIRQ(TIM7_DAC_IRQn);
            } else {
                ras_changed = 1;        /* list end: echo confirms the state */
            }
        }
        else if (ch >= '0' && ch <= '8') {
            md_sel_ch = (uint8_t)(ch - '0');   /* '8' = all channels */
            ras_changed = 1;
        }
        else if (ch == 'r') {
            if (md_raster) {
                /* Back to all-at-once: nothing to restore — the globals were
                 * never touched by raster edits and md_adc_kick reprograms
                 * the pair JSQRs itself. A sweep in flight is abandoned (one
                 * tick gap). */
                md_raster = 0U;
                md_pace_diag_reset();
                ras_changed = 1;
            } else if (md_raster_apply()) {
                md_slot     = 0U;   /* ordered before the mode flag: the pacer
                                       reads slot state only when raster is on */
                md_sweep_ok = 0U;
                md_raster   = 1U;
                md_pace_diag_reset();
                ras_changed = 1;
            } else {
                ras_warn = 1;       /* sweep wouldn't fit the sample interval */
                ras_warn_slot = md_slot_want;
                ras_warn_ivl  = md_interval_ticks();
            }
        }
        else if (ch == 'I') { md_info_request(); }   /* may defer, see above */
        else if (ch == 'P') { md_print_pace(); }
        else if (ch == 'G') {
            gps_passthrough_enabled = !gps_passthrough_enabled;
            printf("# gps passthrough %s\r\n",
                   gps_passthrough_enabled ? "on" : "off");
        }
    }
    if (changed)
        printf("# blanking=%luus  rx_window=%luus\r\n",
               md_blanking_us, md_rx_window_us);
    if (tx_changed)
        printf("# tx_pulse=%luus\r\n", md_tx_pulse_us);
    if (geom_changed)
        printf("# coil_spacing=%lumm\r\n", md_coil_spacing_mm);
    if (rate_changed)
        printf("# sample_rate=%luHz (%u per fix)\r\n",
               md_sample_rate_hz(), md_samples_per_period);
    if (ras_changed)
        md_print_rastercfg();
    if (ras_warn)
        printf("# raster limit: 8 slots of %luus need more than the %luus sample interval -- lower the rate, shrink timings, or speed up the pulse\r\n",
               ras_warn_slot * 100U, ras_warn_ivl * 100U);
    md_info_poll();     /* deferred 'I' reply, after this poll's key echoes */
}

/* Common one-pulse timebase setup: 170 MHz ticks, given end-of-timeline. */
static void md_opm_timebase(TIM_TypeDef *tim, uint32_t arr)
{
    tim->CR1 &= ~TIM_CR1_CEN;
    tim->CR1 |= TIM_CR1_OPM;
    tim->PSC  = 0U;
    tim->ARR  = arr;
    tim->CNT  = 0U;
    tim->EGR  = TIM_EGR_UG;    /* latch PSC now                             */
    tim->SR   = 0U;            /* clear UG-induced UIF and stale flags      */
}

static void md_pace_init(void);   /* TIM7 cycle pacer — defined below */

/* ============================================================================
 * MD_Hardware_Init
 * Called once from the app task after all MX_ inits. Overrides the CubeMX
 * baseline with the hardware-timeline configuration; all pins idle.
 * ========================================================================== */
void MD_Hardware_Init(void)
{
    MD_Load_Settings();   /* apply saved timing before first cycle */

    /* Boot raster-state echo. An MCU reset mid-study reverts RAM state
     * (channel selection to 'all'; mode/tables to the saved record) while
     * the daemon keeps the port — without this line its <key>_current and
     * raster_sel meta would keep describing the pre-reset state, and the
     * raw view would highlight one channel while edits hit all 8. The
     * info line can't carry it: ch= is live UI state, not a header key. */
    md_print_rastercfg();

    const uint32_t tx_arr  = md_tx_pulse_us * MD_TICKS_PER_US;
    const uint32_t aux_arr = (md_tx_pulse_us + md_blanking_us + md_rx_window_us)
                             * MD_TICKS_PER_US;

    /* ---------------- TIM2: master + Set A TX (PA5) ------------------- */
    md_opm_timebase(TIM2, tx_arr);
    TIM2->CR2 = (TIM2->CR2 & ~TIM_CR2_MMS) | TIM_CR2_MMS_0;  /* TRGO = CEN  */
    TIM2->CCR1 = 1U;                       /* TX rise one tick after start  */
    md_oc_mode(TIM2, 1, MD_OCM_FORCE_INACT);
    TIM2->CCER |= TIM_CCER_CC1E;
    TIM2->DIER  = 0U;                      /* no interrupts on TX timers    */

    /* ---------------- TIM3: slave + Set B TX (PB4) -------------------- */
    md_opm_timebase(TIM3, tx_arr);
    md_slave_to_tim2(TIM3);
    TIM3->CCR1 = 1U;
    md_oc_mode(TIM3, 1, MD_OCM_FORCE_INACT);
    TIM3->CCER |= TIM_CCER_CC1E;
    TIM3->DIER  = 0U;

    /* ---------------- TIM1: slave + Set A aux (PA9/PA10/PA11) --------- */
    md_opm_timebase(TIM1, aux_arr);
    md_slave_to_tim2(TIM1);
    md_oc_mode(TIM1, 2, MD_OCM_FORCE_INACT);   /* PA9  LOW  (gain-protect) */
    md_oc_mode(TIM1, 3, MD_OCM_FORCE_INACT);   /* PA10 LOW  (integ reset)  */
    md_oc_mode(TIM1, 4, MD_OCM_FORCE_INACT);   /* PA11 HIGH (RX off, CC4P) */
    TIM1->CCER |= TIM_CCER_CC2E | TIM_CCER_CC3E | TIM_CCER_CC4E | TIM_CCER_CC4P;
    TIM1->CR2  &= ~(TIM_CR2_OIS2 | TIM_CR2_OIS3 | TIM_CR2_OIS4);
    TIM1->BDTR |= TIM_BDTR_MOE | TIM_BDTR_OSSR | TIM_BDTR_OSSI;
    TIM1->DIER  = TIM_DIER_UIE;
    HAL_NVIC_SetPriority(TIM1_UP_TIM16_IRQn, 2, 0);
    HAL_NVIC_EnableIRQ(TIM1_UP_TIM16_IRQn);

    /* ---------------- TIM8: slave + Set B aux (PA15/PB9/PC13) --------- */
    md_opm_timebase(TIM8, aux_arr);
    md_slave_to_tim2(TIM8);
    md_oc_mode(TIM8, 1, MD_OCM_FORCE_INACT);   /* PA15 LOW  (gain-protect) */
    md_oc_mode(TIM8, 3, MD_OCM_FORCE_INACT);   /* PB9  LOW  (integ reset)  */
    md_oc_mode(TIM8, 4, MD_OCM_FORCE_INACT);   /* PC13 HIGH (RX off, CC4NP)*/
    TIM8->CCER |= TIM_CCER_CC1E | TIM_CCER_CC3E | TIM_CCER_CC4NE | TIM_CCER_CC4NP;
    TIM8->CR2  &= ~(TIM_CR2_OIS1 | TIM_CR2_OIS3 | TIM_CR2_OIS4N);
    TIM8->BDTR |= TIM_BDTR_MOE | TIM_BDTR_OSSR | TIM_BDTR_OSSI;
    TIM8->DIER  = TIM_DIER_UIE;
    HAL_NVIC_SetPriority(TIM8_UP_IRQn, 2, 0);
    HAL_NVIC_EnableIRQ(TIM8_UP_IRQn);

    /* ---------------- ADC1..4: injected pairs, all 8 inputs ----------- */
    md_adc_init();

    /* ---------------- ADC5: 1 Hz status (PA8 / temp / VREFINT) -------- */
    md_status_init();

    /* ---------------- TIM7: free-running cycle pacer ------------------- */
    md_pace_init();
}

/* Arm one set for the coming cycle (timers are stopped here, so mode and
 * compare writes are glitch-free). */
static void md_arm_set(md_set_t *s,
                       uint32_t tx_arr, uint32_t aux_ccr, uint32_t aux_arr)
{
    s->tx->ARR  = tx_arr;
    s->opm->ARR = aux_arr;
    md_set_ccr(s->opm, s->gain_ch,  aux_ccr);
    md_set_ccr(s->opm, s->integ_ch, aux_ccr);
    md_set_ccr(s->opm, s->rx_ch,    aux_ccr);

    /* Reset refs LOW first so re-arming can't glitch, then arm. */
    md_oc_mode(s->opm, s->gain_ch,  MD_OCM_FORCE_INACT);
    md_oc_mode(s->opm, s->integ_ch, MD_OCM_FORCE_INACT);
    md_oc_mode(s->opm, s->gain_ch,  MD_OCM_ACT_ON_CMP);  /* latches HIGH      */
    md_oc_mode(s->opm, s->integ_ch, MD_OCM_ACT_ON_CMP);  /* latches HIGH      */
    md_oc_mode(s->opm, s->rx_ch,    MD_OCM_PWM2);        /* hardware window   */

    md_oc_mode(s->tx, 1, MD_OCM_PWM2);   /* coil: rise @1 tick, fall @update */
}

/* ============================================================================
 * md_start_cycle  (called from the TIM7 pacer IRQ — see md_pace_fired)
 * Arms both sets, then starts the master. Every armed timer starts on
 * the same hardware trigger — the only software-timed event is this
 * single CEN write, and nothing downstream depends on when it lands.
 * ========================================================================== */
uint8_t md_start_cycle(void)
{
    if (((TIM2->CR1 | TIM3->CR1 | TIM1->CR1 | TIM8->CR1) & TIM_CR1_CEN)
        || md_adc_done_mask != 0x0FU)
        return 0U;            /* previous cycle (timers or ADC) still running */

    uint32_t tx = md_tx_pulse_us;
    uint32_t bl = md_blanking_us;
    uint32_t rx = md_rx_window_us;
    uint32_t tx_arr  = tx * MD_TICKS_PER_US;
    uint32_t aux_ccr = (tx + bl) * MD_TICKS_PER_US + 1U;
    uint32_t aux_arr = (tx + bl + rx) * MD_TICKS_PER_US;

    md_arm_set(&md_set_a, tx_arr, aux_ccr, aux_arr);
    md_arm_set(&md_set_b, tx_arr, aux_ccr, aux_arr);

    md_cycle_raster = 0U;
    md_ts_cen = dwt_cyccnt();
    TIM2->CR1 |= TIM_CR1_CEN;      /* master + all armed slaves start here   */
    return 1U;
}

/* Park one set for a raster slot it doesn't own: every output forced
 * inactive (coils don't fire, integrators stay reset, RX disconnected —
 * the same refs as the between-cycles idle state). The timers still RUN —
 * they are trigger-slaved to TIM2 and start with it regardless — so they
 * get the slot's ARRs to run out quietly; their UIE is filtered in the
 * handlers below instead of churning DIER per slot. */
static void md_park_set(md_set_t *s, uint32_t tx_arr, uint32_t aux_arr)
{
    s->tx->ARR  = tx_arr;
    s->opm->ARR = aux_arr;
    md_oc_mode(s->tx, 1, MD_OCM_FORCE_INACT);
    md_oc_mode(s->opm, s->gain_ch,  MD_OCM_FORCE_INACT);
    md_oc_mode(s->opm, s->integ_ch, MD_OCM_FORCE_INACT);
    md_oc_mode(s->opm, s->rx_ch,    MD_OCM_FORCE_INACT);
}

/* ============================================================================
 * md_start_slot  (raster mode; called from the TIM7 pacer IRQ)
 * One channel's private cycle: its bus fires with its own {tx, bl, rx},
 * the other bus is parked, and only its ADC channel converts. Same
 * hardware-trigger start and same overlap guard as md_start_cycle.
 * ========================================================================== */
static uint8_t md_start_slot(uint32_t k)
{
    if (((TIM2->CR1 | TIM3->CR1 | TIM1->CR1 | TIM8->CR1) & TIM_CR1_CEN)
        || md_adc_done_mask != 0x0FU)
        return 0U;            /* previous slot (timers or ADC) still running */

    uint32_t tx = md_ch_tx_us[k];
    uint32_t bl = md_ch_bl_us[k];
    uint32_t rx = md_ch_rx_us[k];
    uint32_t tx_arr  = tx * MD_TICKS_PER_US;
    uint32_t aux_ccr = (tx + bl) * MD_TICKS_PER_US + 1U;
    uint32_t aux_arr = (tx + bl + rx) * MD_TICKS_PER_US;

    md_set_t *fire = MD_CH_SET_B(k) ? &md_set_b : &md_set_a;
    md_set_t *idle = MD_CH_SET_B(k) ? &md_set_a : &md_set_b;

    md_arm_set(fire, tx_arr, aux_ccr, aux_arr);
    md_park_set(idle, tx_arr, aux_arr);

    md_slot_ch = (uint8_t)k;       /* settles long before the UIE reads it   */
    md_cycle_raster = 1U;

    md_ts_cen = dwt_cyccnt();
    TIM2->CR1 |= TIM_CR1_CEN;      /* master clock runs every slot; only the
                                      firing set's outputs are armed         */
    return 1U;
}

/* ============================================================================
 * OPM expiry (UIE at end of RX window). Every critical edge this cycle
 * already happened in hardware — the RX disconnect was the PWM2 self-clear
 * at this same update event. All-at-once: TIM1's UIE starts all four ADC
 * sequences. Raster: both aux timers run every slot with the same ARR, so
 * both UIEs fire — only the set that owns the slot's channel kicks.
 * ========================================================================== */
void md_tim1_uie_fired(void)
{
    md_ts_opm = dwt_cyccnt();
    if (!md_cycle_raster)
        md_adc_kick();
    else if (!MD_CH_SET_B(md_slot_ch))
        md_adc_kick_one();
}

void md_tim8_uie_fired(void)
{
    if (md_cycle_raster && MD_CH_SET_B(md_slot_ch))
        md_adc_kick_one();
}

/* ============================================================================
 * Cycle pacing (TIM7, basic timer, one-pulse @ 10 kHz timebase).
 * See metal_detector.h for the cadence contract. The pacer FREE-RUNS: its
 * own expiry ISR is the only place TIM7 is armed (plus md_pace_init's boot
 * arm, before anything can pend), so nothing outside this ISR — not a GPS
 * fix, not the NMEA parser, not the RTOS — can move a coil pulse.
 *
 * History (2026-09-20): until then every valid GGA re-armed TIM7 from the
 * USART2 ISR so a frame completed 1 ms before each fix. That turned the
 * GPS module's sentence-arrival jitter (and the once-per-second GSV block
 * it used to emit) into pulse-interval jitter — post-fix interval anywhere
 * in [I-1 ms, 2I-1 ms) — which the analog chain reads as common-mode
 * noise on every channel (~2k counts per ms of interval change at 200 Hz,
 * bench-measured). Noisy with a lock, quiet with the GPS UART unplugged.
 * The host never needed the lead: it interpolates between anchor ticks,
 * and an anchor's frame completes within one interval before its GGA at
 * any phase. The fix path is now read-only (md_pace_note_fix).
 *
 * NVIC priority 4: above the USART2 GPS parser (6), the GPS DMA IRQ (5)
 * and the FreeRTOS syscall ceiling (5), so none of them can delay an
 * expiry — a delay would be baked into the interval, because the re-arm
 * below resets the counter. Below the timeline ISRs (TIM1/TIM8 UIE at 2,
 * ADC JEOS at 3), which are microseconds long. Consequence: this ISR and
 * everything it calls must never use a FreeRTOS API.
 * ========================================================================== */
static void md_pace_arm_ticks(uint32_t ticks)
{
    /* Floor 2, not 1: ARR gets ticks-1, and a basic timer's counter is
     * BLOCKED while ARR == 0 (RM0440) — a 1-tick arm would park TIM7 dead
     * forever (nothing else ever re-arms it). No caller legitimately
     * wants 1 tick: every path arms at least one slot period (>= 2). */
    if (ticks < 2U)
        ticks = 2U;
    TIM7->CR1 &= ~TIM_CR1_CEN;
    TIM7->ARR  = ticks - 1U;
    TIM7->EGR  = TIM_EGR_UG;   /* latch ARR, reset CNT (URS: no UIF)   */
    /* Belt and braces: OPM stopped the counter at the expiry we are
     * servicing, so no fresh UIF can exist here; but a stale pend costs
     * a doubled fire, so drop both flag and pend anyway. The SR readback
     * orders the flag clear ahead of the pend clear so a still-asserted
     * line can't re-latch (NVIC latches pending on the UIF edge; only
     * exception entry or an ICPR write releases it). */
    TIM7->SR   = 0U;
    (void)TIM7->SR;
    HAL_NVIC_ClearPendingIRQ(TIM7_DAC_IRQn);
    TIM7->CR1 |= TIM_CR1_CEN;
}

static void md_pace_arm(uint32_t ms)
{
    md_pace_arm_ticks(ms * MD_PACE_TICKS_PER_MS);
}

static void md_pace_init(void)
{
    (void)dwt_cyccnt();   /* start the cycle counter the diagnostics stamp */
    md_pace_diag_reset(); /* boot-time GPS traffic (config acks, a saved
                             20 Hz stream) has already stamped the fix
                             side — the first 'P' window starts here */
    __HAL_RCC_TIM7_CLK_ENABLE();
    TIM7->PSC  = (170000U / MD_PACE_TICKS_PER_MS) - 1U;  /* 170 MHz -> 10 kHz */
    /* URS: md_pace_arm's UG reloads PSC/CNT without raising UIF — with
     * UIE live, a UG-induced UIF would pend the IRQ in the NVIC faster
     * than the SR clear can catch it. Only a real expiry interrupts. */
    TIM7->CR1  = TIM_CR1_OPM | TIM_CR1_URS;
    TIM7->DIER = TIM_DIER_UIE;
    /* 4: above USART2 (6), DMA1_Ch1 (5) and the RTOS ceiling (5); below
     * TIM1/TIM8 UIE (2) and ADC (3). See the section comment. */
    HAL_NVIC_SetPriority(TIM7_DAC_IRQn, 4, 0);
    HAL_NVIC_EnableIRQ(TIM7_DAC_IRQn);
    md_pace_arm(1U);   /* first frame right away; the fixed cadence follows */
}

/* Pacer ISR: stamp a started cycle (all mode) or sweep (raster slot 0)
 * and fold its interval into the 'P' statistics. `now` is md_ts_cen, the
 * DWT count at the master timer's CEN write — the coil pulse itself. */
static void md_pace_diag_fire(uint32_t now)
{
    uint32_t prev = md_pd_fire_cyc;
    md_pd_fire_cyc = now;
    md_pd_fires++;
    if (prev == 0U)
        return;                             /* window start: no interval */
    uint32_t ivl = md_cyc_to_us(now - prev);
    uint32_t nom = md_interval_ticks() * 100U;
    uint32_t dev = (ivl > nom) ? ivl - nom : nom - ivl;
    if (dev > md_pd_dev_max)
        md_pd_dev_max = dev;
    uint32_t pi = md_pd_prev_ivl;
    if (pi != 0U) {
        uint32_t jit = (ivl > pi) ? ivl - pi : pi - ivl;
        if (jit > md_pd_jit_max)
            md_pd_jit_max = jit;
    }
    md_pd_prev_ivl = ivl;
}

/* USART2 IRQ context (priority 6). Diagnostics ONLY: reads the fire stamp,
 * never touches TIM7 or any pacer state. A pacer fire preempting the two
 * reads below can skew fix_ph_us for one sample — it steers nothing. */
void md_pace_note_fix(void)
{
    uint32_t fire    = md_pd_fire_cyc;
    uint32_t now     = dwt_cyccnt();
    uint32_t now_ms  = HAL_GetTick();       /* plain volatile read, ISR-safe */
    uint32_t last    = md_pd_fix_cyc;
    uint32_t last_ms = md_pd_fix_ms;
    md_pd_fix_cyc = now;
    md_pd_fix_ms  = now_ms;
    md_pd_fix_n++;
    if (fire != 0U)
        md_pd_fix_ph = md_cyc_to_us(now - fire);
    if (last == 0U)
        return;
    /* > 1 s since the last valid GGA is a dropout, not arrival jitter.
     * Judged on the ms tick, not the cycle count: CYCCNT wraps every
     * 25.27 s, so a 25.5 s or 51 s outage would otherwise read as a
     * sub-second span and pollute min/max. */
    if (now_ms - last_ms > 1000U)
        return;
    uint32_t span = md_cyc_to_us(now - last);
    if (span < md_pd_fix_span_min)
        md_pd_fix_span_min = span;
    if (span > md_pd_fix_span_max)
        md_pd_fix_span_max = span;
}

/* USART2 IRQ context: NMEA parse duration since start_cyc (DWT). The
 * _begin side goes through dwt_cyccnt() so the counter is switched on by
 * the first sentence to arrive, even before md_pace_init — a raw
 * DWT->CYCCNT read with TRCENA clear is architecturally undefined. */
uint32_t md_pace_gps_isr_begin(void)
{
    return dwt_cyccnt();
}

void md_pace_note_gps_isr(uint32_t start_cyc)
{
    uint32_t us = md_cyc_to_us(dwt_cyccnt() - start_cyc);
    if (us > md_pd_gps_isr_max)
        md_pd_gps_isr_max = us;
}

void md_pace_fired(void)
{
    if ((TIM7->SR & TIM_SR_UIF) == 0U)
        return;                     /* not ours (DAC shares the vector) */
    TIM7->SR = 0U;                          /* clear UIF */

    if (!md_raster) {
        /* Every fire consumes a tick, started or not: a skipped slot
         * (previous cycle still in flight — never happens at a 2 ms
         * interval vs ~185 us cycles, but the guard stands) leaves a tick
         * gap instead of quietly relabeling time. The in-flight number is
         * set only on a real start so a frame still converting keeps its
         * own tick. */
        uint32_t tick = md_sample_tick + 1U;
        md_sample_tick = tick;
        if (md_start_cycle()) {
            md_tick_inflight = tick;
            md_pace_diag_fire(md_ts_cen);
        } else {
            md_pd_skips++;
        }
        /* Re-arm at the sample interval, unconditionally and from nowhere
         * else: with or without a GPS fix the stream runs at the
         * configured rate — full rate for bench work with no GPS attached,
         * and the front end keeps its field thermal duty cycle (see the
         * cadence contract in metal_detector.h). */
        md_pace_arm_ticks(md_interval_ticks());
        return;
    }

    /* Raster: one tick per SWEEP (the frame keeps today's cadence and the
     * host's tick math is untouched); the 8 slots ride TIM7 re-arms at the
     * fixed slot period, so value k is measured k*slot_period after the
     * sweep start — the deterministic skew the host corrects for. A slot
     * that finds the previous one still running (budget overrun) kills
     * the sweep: no frame, tick gap, remaining slots skipped (no point
     * heating coils for a frame that won't publish). */
    if (md_slot == 0U) {
        uint32_t tick = md_sample_tick + 1U;
        md_sample_tick = tick;
        md_sweep_ok = md_start_slot(0U);
        if (md_sweep_ok) {
            md_tick_inflight = tick;
            md_pace_diag_fire(md_ts_cen);
        } else {
            md_pd_skips++;
        }
        md_slot = 1U;
        md_pace_arm_ticks(md_slot_ticks);
        return;
    }

    if (md_sweep_ok && !md_start_slot(md_slot)) {
        md_sweep_ok = 0U;
        md_pd_skips++;
    }
    md_slot++;
    if (md_slot < 8U) {
        md_pace_arm_ticks(md_slot_ticks);
        return;
    }

    /* Slot 7 just fired: arm the remainder of the sample interval (the
     * fit check guarantees interval >= 8 slots, so this never underflows
     * below one slot). Sweep-to-sweep spacing is therefore exactly the
     * sample interval, GPS or no GPS. */
    md_slot = 0U;
    md_pace_arm_ticks(md_interval_ticks() - 7U * (uint32_t)md_slot_ticks);
}

/* ============================================================================
 * Injected-sequence completion (JEOS), one per ADC. The last one to land
 * releases gain + integ on both sets: every integrator has been sampled by
 * then.
 * ========================================================================== */
static void md_adc_collect(uint32_t i)
{
    const md_adc_pair_t *p = &md_adc_pairs[i];

    p->adc->ISR = ADC_ISR_JEOS | ADC_ISR_JEOC;          /* clear flags       */

    if (md_kick_raster) {
        /* Raster slot: one conversion, one channel. Release gain+integ on
         * the firing set (the parked set is already forced inactive) and
         * publish the frame only when slot 7 completes a clean sweep. */
        uint32_t k = md_slot_ch;
        md_adc[k] = (uint16_t)p->adc->JDR1;
        md_adc_done_mask = 0x0FU;
        md_set_t *s = MD_CH_SET_B(k) ? &md_set_b : &md_set_a;
        md_oc_mode(s->opm, s->gain_ch,  MD_OCM_FORCE_INACT);
        md_oc_mode(s->opm, s->integ_ch, MD_OCM_FORCE_INACT);
        if (k == 7U && md_sweep_ok) {
            md_cycle_count++;
            uint32_t head = md_frame_head;
            if (head - md_frame_tail < MD_FRAME_RING) {
                md_frame_t *f = &md_frame_ring[head & (MD_FRAME_RING - 1U)];
                f->tick = md_tick_inflight;
                for (uint32_t j = 0U; j < MD_ADC_COUNT; j++)
                    f->adc[j] = md_adc[j];
                md_frame_head = head + 1U;
            } else {
                md_frame_overruns++;
            }
            md_tick_completed = md_tick_inflight;
        }
        return;
    }

    md_adc[p->idx]      = (uint16_t)p->adc->JDR1;
    md_adc[p->idx + 1U] = (uint16_t)p->adc->JDR2;

    uint8_t done = md_adc_done_mask | (uint8_t)(1U << i);
    md_adc_done_mask = done;
    if (done == 0x0FU) {
        md_oc_mode(md_set_a.opm, md_set_a.gain_ch,  MD_OCM_FORCE_INACT);
        md_oc_mode(md_set_a.opm, md_set_a.integ_ch, MD_OCM_FORCE_INACT);
        md_oc_mode(md_set_b.opm, md_set_b.gain_ch,  MD_OCM_FORCE_INACT);
        md_oc_mode(md_set_b.opm, md_set_b.integ_ch, MD_OCM_FORCE_INACT);
        md_cycle_count++;

        /* Frame complete: queue it for the app task's sample line. The
         * head bump publishes after the payload; a full ring drops the
         * frame whole (its tick gap is the host's signal). */
        uint32_t head = md_frame_head;
        if (head - md_frame_tail < MD_FRAME_RING) {
            md_frame_t *f = &md_frame_ring[head & (MD_FRAME_RING - 1U)];
            f->tick = md_tick_inflight;
            for (uint32_t k = 0U; k < MD_ADC_COUNT; k++)
                f->adc[k] = md_adc[k];
            md_frame_head = head + 1U;
        } else {
            md_frame_overruns++;
        }
        md_tick_completed = md_tick_inflight;
    }
}

/* Raw IRQ hooks — called from the handlers in stm32g4xx_it.c USER CODE 1 */
void md_adc12_irq(void)
{
    if (ADC1->ISR & ADC_ISR_JEOS) md_adc_collect(0U);
    if (ADC2->ISR & ADC_ISR_JEOS) md_adc_collect(1U);
}

void md_adc3_irq(void)
{
    if (ADC3->ISR & ADC_ISR_JEOS) md_adc_collect(2U);
}

void md_adc4_irq(void)
{
    if (ADC4->ISR & ADC_ISR_JEOS) md_adc_collect(3U);
}
